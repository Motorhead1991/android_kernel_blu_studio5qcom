/* Copyright (c) 2013, The Linux Foundation. All rights reserved.
 *
 * This program is free software; you can redistribute it and/or modify
 * it under the terms of the GNU General Public License version 2 and
 * only version 2 as published by the Free Software Foundation.
 *
 * This program is distributed in the hope that it will be useful,
 * but WITHOUT ANY WARRANTY; without even the implied warranty of
 * MERCHANTABILITY or FITNESS FOR A PARTICULAR PURPOSE.  See the
 * GNU General Public License for more details.
 */

/*---------------------------------------------------------------------------
 * This file is autogenerated file using gcdb parser. Please do not edit it.
 * Update input XML file to add a new entry or update variable in this file
 * VERSION = "1.0"
 *---------------------------------------------------------------------------*/
&mdss_mdp {
	dsi_ty_hx8389b_qhd_vid: qcom,mdss_dsi_ty_hx8389b_qhd_video {
		qcom,mdss-dsi-panel-name = "ty_hx8389b qhd video mode dsi panel";
                qcom,cont-splash-enabled;
		qcom,mdss-dsi-panel-controller = <&mdss_dsi0>;
		qcom,mdss-dsi-panel-type = "dsi_video_mode";
		qcom,mdss-dsi-panel-destination = "display_1";
		qcom,mdss-dsi-panel-framerate = <58>;
		qcom,mdss-dsi-virtual-channel-id = <0>;
		qcom,mdss-dsi-stream = <0>;
		qcom,mdss-dsi-panel-width = <540>;
		qcom,mdss-dsi-panel-height = <960>;
		qcom,mdss-dsi-h-front-porch = <60>;
		qcom,mdss-dsi-h-back-porch = <60>;
		qcom,mdss-dsi-h-pulse-width = <2>;
		qcom,mdss-dsi-h-sync-skew = <0>;
		qcom,mdss-dsi-v-back-porch = <5>;
		qcom,mdss-dsi-v-front-porch = <9>;
		qcom,mdss-dsi-v-pulse-width = <2>;
		qcom,mdss-dsi-h-left-border = <0>;
		qcom,mdss-dsi-h-right-border = <0>;
		qcom,mdss-dsi-v-top-border = <0>;
		qcom,mdss-dsi-v-bottom-border = <0>;
		qcom,mdss-dsi-bpp = <24>;
		qcom,mdss-dsi-color-order = "rgb_swap_rgb";
		qcom,mdss-dsi-underflow-color = <0xff>;
		qcom,mdss-dsi-border-color = <0>;
		qcom,mdss-dsi-pixel-packing = "tight";
		qcom,mdss-dsi-on-command = [
                39 01 00 00 00 00 04
                      B9 FF 83 89 
                39 01 00 00 00 00 08
                      BA 41 93 00 
                      16 A4 00 18
                39 01 00 00 00 00 14
                      B1 00 00 07 
                      E6 4F 10 10 
                      AF EF 02 0A 
                      1A 1A 43 00 
                      5A F1 00 08
 	 	39 01 00 00 00 00 08
                     B2 00 00 78 
                     04 07 3F 80
 	 	39 01 00 00 00 00 18
                     B4 00 0E 00 
                     32 10 02 32 
                     13 C6 32 10 
                     00 17 01 48 
                     06 17 01 3C 
                     14 60 68 0A
                15 01 00 00 00 00 02
                      CC 02
 	 	39 01 00 00 00 00 31
                     D5 00 00 00 
                     00 01 00 00 
                     01 E0 18 88 
                     88 01 23 08 
                     48 81 85 28 
                     68 83 87 87 
                     85 68 48 88 
                     88 88 88 88 
                     76 54 78 38 
                     86 82 58 18 
                     84 80 80 82 
                     18 38 88 88 
                     88
 	 	39 01 00 00 00 00 23
                    E0 00 05 0F 
                     20 33 3F 1D 
                     3A 08 0C 0F 
                     13 15 13 14 
                     1E 1F 00 05 
                     0F 20 33 3F 
                     1D 3A 08 0C 
                     0F 13 15 13 
                     14 1E 1F 
 	 	39 01 00 00 00 00 80
                     C1 01 00 05 
                     08 1A 22 29 
                     2F 34 3C 44 
                     4C 55 5D 65 
                     6E 76 7F 86 
                     8E 97 9F A6 
                     AE B7 C0 C7 
                     CD D5 DE E5 
                     EE F7 FF 23 
	             AA E8 23 7D 
	             3C 39 1C C0 
	             00 05 08 1A 
	             22 29 2F 34 
	             3C 44 4C 55 
	             5D 65 6E 76 
	             7F 86 8E 97 
	             9F A6 AE B7 
	             C0 C7 CD D5 
	             DE E5 EE F7 
	             FF 23 AA E8 
	             23 7D 3C 39 
	             1C C0 00 05 
	             08 1A 22 29 
	             2F 34 3C 44 
	             4C 55 5D 65 
	             6E 76 7F 86 
	             8E 97 9F A6 
	             AE B7 C0 C7 
	             CD D5 DE E5 
	             EE F7 FF 23 
	             AA E8 23 7D 
	             3C 39 1C C0
 	 	39 01 00 00 00 00 06
                     B6 00 70 00 
                     70 E0 
                39 01 00 00 00 00 03
                      CB 07 07 
 	 	39 01 00 00 00 00 05
                     BB 00 00 FF 
                     80
		05 01 00 00 C8 00 02 11 00 
	 	05 01 00 00 14 00 02 29 00];
		qcom,mdss-dsi-off-command = [
		05 01 00 00 32 00 02 28 00 
		05 01 00 00 78 00 02 10 00 
		];
		qcom,mdss-dsi-on-command-state = "dsi_lp_mode";
		qcom,mdss-dsi-off-command-state = "dsi_lp_mode";
		qcom,mdss-dsi-h-sync-pulse = <0>;
		qcom,mdss-dsi-traffic-mode = "non_burst_sync_event";
		qcom,mdss-dsi-lane-map = "lane_map_3012";
		qcom,mdss-dsi-bllp-eof-power-mode;
		qcom,mdss-dsi-lane-0-state;
		qcom,mdss-dsi-lane-1-state;
		qcom,mdss-dsi-panel-timings = [a8 1f 17 00 2f 2d 1c 21 29 03 04 00];
		qcom,mdss-dsi-t-clk-post = <0x20>;
		qcom,mdss-dsi-t-clk-pre = <0x2f>;
		qcom,mdss-dsi-bl-min-level = <1>;
		qcom,mdss-dsi-bl-max-level = <4095>;
		qcom,mdss-dsi-dma-trigger = "trigger_sw";
		qcom,mdss-dsi-mdp-trigger = "none";
		qcom,mdss-dsi-bl-pmic-control-type = "bl_ctrl_wled";
		qcom,mdss-dsi-reset-sequence = <1 20>, <0 2>, <1 20>;
		qcom,mdss-dsi-lp11-init;
		qcom,mdss-dsi-init-delay-us = <50000>;
	};
};
