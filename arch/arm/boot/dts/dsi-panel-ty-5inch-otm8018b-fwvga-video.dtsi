/* Copyright (c) 2013, The Linux Foundation. All rights reserved.
 *
 * This program is free software; you can redistribute it and/or modify
 * it under the terms of the GNU General Public License version 2 and
 * only version 2 as published by the Free Software Foundation.
 *
 * This program is distributed in the hope that it will be useful,
 * but WITHOUT ANY WARRANTY; without even the implied warranty of
 * MERCHANTABILITY or FITNESS FOR A PARTICULAR PURPOSE.  See the
 * GNU General Public License for more details.
 */

/*---------------------------------------------------------------------------
 * This file is autogenerated file using gcdb parser. Please do not edit it.
 * Update input XML file to add a new entry or update variable in this file
 * VERSION = "1.0"
 *---------------------------------------------------------------------------*/
&mdss_mdp {
	dsi_ty_ofilm_otm8018b_fwvga_vid: qcom,mdss_dsi_ofilm_5inch_otm8018b_fwvga_video {
		qcom,mdss-dsi-panel-name = "OTM8018b ty 5inch ofilm fwvga video mode dsi panel";
 		qcom,cont-splash-enabled;
		qcom,mdss-dsi-panel-controller = <&mdss_dsi0>;
		qcom,mdss-dsi-panel-type = "dsi_video_mode";
		qcom,mdss-dsi-panel-destination = "display_1";
		qcom,mdss-dsi-panel-framerate = <60>;
		qcom,mdss-dsi-virtual-channel-id = <0>;
		qcom,mdss-dsi-stream = <0>;
		qcom,mdss-dsi-panel-width = <480>;
		qcom,mdss-dsi-panel-height = <854>;
		qcom,mdss-dsi-h-front-porch = <80>;
		qcom,mdss-dsi-h-back-porch = <54>;
		qcom,mdss-dsi-h-pulse-width = <8>;
		qcom,mdss-dsi-h-sync-skew = <0>;
		qcom,mdss-dsi-v-back-porch = <16>;
		qcom,mdss-dsi-v-front-porch = <12>;
		qcom,mdss-dsi-v-pulse-width = <2>;
		qcom,mdss-dsi-h-left-border = <0>;
		qcom,mdss-dsi-h-right-border = <0>;
		qcom,mdss-dsi-v-top-border = <0>;
		qcom,mdss-dsi-v-bottom-border = <0>;
		qcom,mdss-dsi-bpp = <24>;
		qcom,mdss-dsi-underflow-color = <0xff>;
		qcom,mdss-dsi-border-color = <0>;
		qcom,mdss-dsi-on-command = [
                 29 01 00 00 00 00 02 00 00 
                 29 01 00 00 00 00 04 ff 80 09 01 
                 29 01 00 00 00 00 02 00 80 
                 29 01 00 00 00 00 03 ff 80 09 
                 29 01 00 00 00 00 02 00 8B 
                 29 01 00 00 00 00 02 B0 40 
                 29 01 00 00 00 00 02 00 C6 
                 29 01 00 00 00 00 02 B0 03 
                 29 01 00 00 00 00 02 00 40 
                 29 01 00 00 00 00 02 B3 45 
                 29 01 00 00 00 00 02 00 90 
                 29 01 00 00 00 00 02 B3 02 
                 29 01 00 00 00 00 02 00 92 
                 29 01 00 00 00 00 02 B3 45 
                 29 01 00 00 00 00 02 00 80 
                 29 01 00 00 00 00 06 c0 00 58 00 14 16 
                 29 01 00 00 00 00 02 00 90 
                 29 01 00 00 00 00 07 c0 00 44 00 00 00 03 
                 29 01 00 00 00 00 02 00 A3 
                 29 01 00 00 00 00 02 C0 1B 
                 29 01 00 00 00 00 02 00 B4 
                 29 01 00 00 00 00 02 c0 10 
                 29 01 00 00 00 00 02 00 81 
                 29 01 00 00 00 00 02 C1 66 
                 29 01 00 00 00 00 02 00 A0 
                 29 01 00 00 00 00 03 C1 EA 08 
                 29 01 00 00 00 00 02 00 A6 
                 29 01 00 00 00 00 04 C1 01 00 00 
                 29 01 00 00 00 00 02 00 80 
                 29 01 00 00 00 00 03 C4 30 83 
                 29 01 00 00 00 00 02 00 88 
                 29 01 00 00 00 00 02 C4 80 
                 29 01 00 00 00 00 02 00 8A 
                 29 01 00 00 00 00 02 C4 40 
                 29 01 00 00 00 00 02 00 82 
                 29 01 00 00 00 00 02 c5 A3 
                 29 01 00 00 00 00 02 00 90 
                 29 01 00 00 00 00 05 c5 96 76 01 03 
                 29 01 00 00 00 00 02 00 B1 
                 29 01 00 00 00 00 06 c5 A9 15 00 15 00 
                 29 01 00 00 00 00 02 00 C0 
                 29 01 00 00 00 00 02 c5 00 
                 29 01 00 00 00 00 02 00 B2 
                 29 01 00 00 00 00 05 F5 15 00 15 00 
                 29 01 00 00 00 00 02 00 80 
                 29 01 00 00 00 00 07 CE 8B 03 03 8A 03 03 
                 29 01 00 00 00 00 02 00 90 
                 29 01 00 00 00 00 0f CE 23 58 01 23 59 01 33 5B 00 33 5C 00 00 00 
                 29 01 00 00 00 00 02 00 A0 
                 29 01 00 00 00 00 0f CE 38 09 03 5A 00 03 00 38 08 03 5B 00 03 00 
                 29 01 00 00 00 00 02 00 B0 
                 29 01 00 00 00 00 0f CE 38 07 03 54 00 03 00 38 06 03 55 00 03 00 
                 29 01 00 00 00 00 02 00 C0 
                 29 01 00 00 00 00 0f CE 38 05 03 56 00 03 00 38 04 03 57 00 03 00 
                 29 01 00 00 00 00 02 00 D0 
                 29 01 00 00 00 00 0f CE 38 03 03 58 00 03 00 38 02 03 59 00 03 00 
                 29 01 00 00 00 00 02 00 C0 
                 29 01 00 00 00 00 0b CF 3D 00 00 00 00 00 01 00 00 00 
                 29 01 00 00 00 00 02 00 80 
                 29 01 00 00 00 00 0b CB 00 00 00 00 00 00 00 00 00 00 
                 29 01 00 00 00 00 02 00 90 
                 29 01 00 00 00 00 10 CB 00 00 00 00 00 00 00 00 00 00 00 00 00 00 00 
                 29 01 00 00 00 00 02 00 A0 
                 29 01 00 00 00 00 10 CB 00 00 00 00 00 00 00 00 00 00 00 00 00 00 00 
                 29 01 00 00 00 00 02 00 B0 
                 29 01 00 00 00 00 0b CB 00 00 00 00 00 00 00 00 00 00 
                 29 01 00 00 00 00 02 00 C0 
                 29 01 00 00 00 00 10 CB 00 00 14 14 14 14 14 00 14 14 00 14 14 14 14 
                 29 01 00 00 00 00 02 00 D0 
                 29 01 00 00 00 00 10 CB 00 00 00 00 00 00 00 14 14 14 14 14 00 14 14 
                 29 01 00 00 00 00 02 00 E0 
                 29 01 00 00 00 00 0b CB 00 14 14 14 14 00 00 00 00 00 
                 29 01 00 00 00 00 02 00 F0 
                 29 01 00 00 00 00 0b CB FF FF FF FF FF FF FF FF FF FF 
                 29 01 00 00 00 00 02 00 80 
                 29 01 00 00 00 00 0b CC 00 00 02 0A 0C 0E 10 00 21 22 
                 29 01 00 00 00 00 02 00 90 
                 29 01 00 00 00 00 10 CC 00 06 25 25 08 00 00 00 00 00 00 00 01 09 0B 
                 29 01 00 00 00 00 02 00 A0 
                 29 01 00 00 00 00 10 CC 0D 0F 00 21 22 00 05 25 25 07 00 00 00 00 00 
                 29 01 00 00 00 00 02 00 B0 
                 29 01 00 00 00 00 0b CC 00 00 05 09 0F 0D 0B 00 21 22 
                 29 01 00 00 00 00 02 00 C0 
                 29 01 00 00 00 00 10 CC 00 01 25 25 07 00 00 00 00 00 00 00 06 0A 10 
                 29 01 00 00 00 00 02 00 D0 
                 29 01 00 00 00 00 10 CC 0E 0C 00 21 22 00 02 25 25 08 00 00 00 00 00 
                 29 01 00 00 00 00 02 00 C0 
                 29 01 00 00 00 00 10 CC 00 01 25 25 07 00 00 00 00 00 00 00 06 0A 10 
                 29 01 00 00 00 00 02 00 D0 
                 29 01 00 00 00 00 10 CC 0E 0C 00 21 22 00 02 25 25 08 00 00 00 00 00 
                 29 01 00 00 00 00 02 00 00 
                 29 01 00 00 00 00 03 D8 6F 6F 
                 29 01 00 00 00 00 02 00 00 
                 29 01 00 00 00 00 02 D9 58 
                 29 01 00 00 00 00 02 00 00 
                 29 01 00 00 00 00 11 E1 02 06 0c 10 09 1B 0E 0D 00 04 03 06 0E 27 23 1B 
                 29 01 00 00 00 00 02 00 00 
                 29 01 00 00 00 00 11 E2 02 06 0c 10 09 1C 0E 0D 01 05 03 07 0E 26 23 1B 
                 29 01 00 00 00 00 02 00 00 
                 29 01 00 00 00 00 04 FF 00 00 00 
	      05 01 00 00 64 00 02 11 00
	      05 01 00 00 20 00 02 29 00];

		qcom,mdss-dsi-off-command = [05 01 00 00 32 00 02 28 00
					05 01 00 00 78 00 02 10 00];
		qcom,mdss-dsi-on-command-state = "dsi_lp_mode";
		qcom,mdss-dsi-off-command-state = "dsi_lp_mode";
		qcom,mdss-dsi-h-sync-pulse = <0>;
		qcom,mdss-dsi-traffic-mode = "non_burst_sync_event";
		qcom,mdss-dsi-lane-map = "lane_map_3012";
		qcom,mdss-dsi-bllp-eof-power-mode;
		qcom,mdss-dsi-bllp-power-mode;
		qcom,mdss-dsi-lane-0-state;
		qcom,mdss-dsi-lane-1-state;
		qcom,mdss-dsi-panel-timings = [8B 1F 14 00 45 4A 19 23 23 03 04 00];
		qcom,mdss-dsi-t-clk-post = <0x04>;
		qcom,mdss-dsi-t-clk-pre = <0x1b>;
		qcom,mdss-dsi-bl-min-level = <1>;
		qcom,mdss-dsi-bl-max-level = <4095>;
		qcom,mdss-dsi-dma-trigger = "trigger_sw";
		qcom,mdss-dsi-mdp-trigger = "none";
		qcom,mdss-dsi-bl-pmic-control-type = "bl_ctrl_wled";
		qcom,mdss-dsi-reset-sequence = <1 20>, <0 2>, <1 20>;
		qcom,mdss-dsi-lp11-init;
		qcom,mdss-dsi-init-delay-us = <50000>;

	};
};
