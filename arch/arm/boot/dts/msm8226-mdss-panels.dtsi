/* Copyright (c) 2013, The Linux Foundation. All rights reserved.
 *
 * This program is free software; you can redistribute it and/or modify
 * it under the terms of the GNU General Public License version 2 and
 * only version 2 as published by the Free Software Foundation.
 *
 * This program is distributed in the hope that it will be useful,
 * but WITHOUT ANY WARRANTY; without even the implied warranty of
 * MERCHANTABILITY or FITNESS FOR A PARTICULAR PURPOSE.  See the
 * GNU General Public License for more details.
 */

/include/ "dsi-panel-hx8394a-720p-video.dtsi"
/include/ "dsi-panel-nt35590-720p-video.dtsi"
/include/ "dsi-panel-nt35521-720p-video.dtsi"
/include/ "dsi-panel-nt35596-1080p-video.dtsi"
/include/ "dsi-panel-nt35590-720p-cmd.dtsi"
/include/ "dsi-panel-ssd2080m-720p-video.dtsi"
/include/ "dsi-panel-jdi-1080p-video.dtsi"
/*TYRD wuxh add for 5inch fwvga lcd on 20131226 begin */
/include/ "dsi-panel-ty-5inch-otm8018b-fwvga-video.dtsi"
/include/ "dsi-panel-ty-5inch-trust-otm8018b-fwvga-video.dtsi"
/include/ "dsi-panel-ty-5inch-truly-fwvga-hx8379a-video.dtsi"
/include/ "dsi-panel-ty-hx8389b-qhd-video.dtsi"
/include/ "dsi-panel-ty-hx8389b-qhd-video-truly-lg.dtsi"
/include/ "dsi-panel-ty-tianma-otm8018b-fwvga-video.dtsi"
/include/ "dsi-panel-ty-ofilm-otm9605a-qhd-video.dtsi"
/*TYRD wuxh add for 5inch fwvga lcd on 20131226 end */

/*TYRD jinxr add for 4.5inch fwvga lcd begin*/
/include/ "dsi-panel-ty-45inch-ofilm-fwvga-hx8379a-video.dtsi"
/include/ "dsi-panel-ty-45inch-truly-fwvga-hx8379a-video.dtsi"
/include/ "dsi-panel-ty-45inch-trust-otm8018b-fwvga-video.dtsi"
/*TYRD jinxr add for 4.5inch fwvga lcd end*/

/*TYDRV:chenjp 2014.01.21 add for 5inch ofilm otm1283a 720p lcd support*/
/include/ "dsi-panel-ty-5inch-ofilm-otm1283a-720p-video.dtsi"
/*TYDRV:xiangdong add for 4.5inch trust ips fwvga lcd on 20140120*/
/include/ "dsi-panel-ty-45ips-trust-otm8018b-fwvga-video.dtsi"
/include/ "dsi-panel-ty-55inch-otm9605a-qhd-video.dtsi"
/*TYRD wuchx add for 5.5inch HD lcd*/
/include/ "dsi-panel-ty-hx8394a-720p-video.dtsi"
/*TYRD lichm add for 5inch HD lcd*/
/include/ "dsi-panel-ty-5inch-hx8394a-hd-video.dtsi"