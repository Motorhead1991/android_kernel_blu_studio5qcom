/* Copyright (c) 2013, The Linux Foundation. All rights reserved.
 *
 * This program is free software; you can redistribute it and/or modify
 * it under the terms of the GNU General Public License version 2 and
 * only version 2 as published by the Free Software Foundation.
 *
 * This program is distributed in the hope that it will be useful,
 * but WITHOUT ANY WARRANTY; without even the implied warranty of
 * MERCHANTABILITY or FITNESS FOR A PARTICULAR PURPOSE.  See the
 * GNU General Public License for more details.
 */

qcom,qrd-4v35-3200mah-data {
	qcom,fcc-mah = <3200>;
	qcom,default-rbatt-mohm = <150>;
	qcom,rbatt-capacitive-mohm = <0>;
	qcom,flat-ocv-threshold-uv = <3800000>;
	qcom,max-voltage-uv = <4350000>;
	qcom,v-cutoff-uv = <3400000>;
	qcom,chg-term-ua = <100000>;
	qcom,batt-id-kohm = <130 115>;

	qcom,rbatt-sf-lut {
		qcom,lut-col-legend = <(-20) 0 25 40 60>;
		qcom,lut-row-legend = <100 95 90 85 80>,
				<75 70 65 60 55>,
				<50 45 40 35 30>,
				<25 20 15 10 9>,
				<8 7 6 5 4>,
				<3 2 1 0>;
		qcom,lut-data = <1217 269 94  83  78 >,
										<1180 255 88  78  71 >,
										<1100 246 87  78  70 >,
										<1055 241 86  78  70 >,
										<1004 242 88  78  70 >,
										<972  251 84  78  69 >,
										<926  249 101 88  69 >,
										<873  219 85  82  70 >,
										<863  206 105 93  72 >,
										<858  188 107 100 85 >,
										<849  176 75  69  58 >,
										<846  172 62  58  52 >,
										<842  172 61  58  52 >,
										<855  172 62  59  53 >,
										<885  177 61  61  55 >,
										<908  189 61  56  56 >,
										<958  204 65  59  51 >,
										<1016 239 76  70  57 >,
										<1058 261 64  55  44 >,
										<1082 285 62  52  46 >,
										<1104 321 65  56  49 >,
										<1128 379 70  60  58 >,
										<1153 482 83  72  103>,
										<1174 676 142 137 195>,
										<1164 904 251 235 316>,
										<1158 688 436 419 310>,
										<1151 556 550 518 246>,
										<1146 451 550 518 246>,
										<1141 638 602 561 307>;
	};

	qcom,fcc-temp-lut {
		qcom,lut-col-legend = <(-20) 0 25 40 60>;
		qcom,lut-data = <2675 3200 3220 3230 3210>;
	};

	qcom,pc-temp-ocv-lut {
		qcom,lut-col-legend = <(-20) 0 25 40 60>;
		qcom,lut-row-legend = <100 95 90 85 80>,
				<75 70 65 60 55>,
				<50 45 40 35 30>,
				<25 20 15 10 9>,
				<8 7 6 5 4>,
				<3 2 1 0>;
		qcom,lut-data = <4350 4349 4347 4340 4338>,
										<4277 4303 4305 4301 4295>,
										<4206 4249 4233 4231 4240>,
										<4166 4183 4182 4179 4171>,
										<4111 4135 4133 4130 4121>,
										<4062 4080 4072 4067 4059>,
										<4011 4016 4021 4021 4015>,
										<3952 3962 3977 3984 3976>,
										<3917 3922 3940 3938 3940>,
										<3897 3882 3906 3905 3897>,
										<3868 3850 3858 3856 3848>,
										<3841 3820 3821 3820 3822>,
										<3826 3803 3804 3803 3798>,
										<3808 3790 3790 3788 3784>,
										<3797 3781 3776 3774 3772>,
										<3791 3777 3768 3758 3751>,
										<3782 3769 3756 3745 3732>,
										<3772 3737 3737 3713 3714>,
										<3763 3700 3694 3684 3668>,
										<3759 3696 3690 3680 3667>,
										<3754 3693 3689 3679 3666>,
										<3749 3690 3687 3678 3665>,
										<3744 3685 3686 3677 3661>,
										<3738 3661 3682 3670 3628>,
										<3732 3576 3642 3624 3544>,
										<3728 3446 3545 3527 3398>,
										<3724 3365 3462 3442 3320>,
										<3721 3302 3362 3342 3290>,
										<3000 3000 3000 3000 3000>;
	};
};
