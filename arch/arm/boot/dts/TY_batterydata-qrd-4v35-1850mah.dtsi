/* Copyright (c) 2013, The Linux Foundation. All rights reserved.
 *
 * This program is free software; you can redistribute it and/or modify
 * it under the terms of the GNU General Public License version 2 and
 * only version 2 as published by the Free Software Foundation.
 *
 * This program is distributed in the hope that it will be useful,
 * but WITHOUT ANY WARRANTY; without even the implied warranty of
 * MERCHANTABILITY or FITNESS FOR A PARTICULAR PURPOSE.  See the
 * GNU General Public License for more details.
 */

qcom,qrd-4v35-1850mah-data {
	qcom,fcc-mah = <1850>;
	qcom,default-rbatt-mohm = <150>;
	qcom,rbatt-capacitive-mohm = <0>;
	qcom,flat-ocv-threshold-uv = <3800000>;
	qcom,max-voltage-uv = <4350000>;
	qcom,v-cutoff-uv = <3400000>;
	qcom,chg-term-ua = <100000>;
	qcom,batt-id-kohm = <130 115>;

	qcom,rbatt-sf-lut {
		qcom,lut-col-legend = <(-20) 0 25 40 60>;
		qcom,lut-row-legend = <100 95 90 85 80>,
				<75 70 65 60 55>,
				<50 45 40 35 30>,
				<25 20 15 10 9>,
				<8 7 6 5 4>,
				<3 2 1 0>;
		qcom,lut-data = <520  130 100 96  89 >,
				<562  212 102 97  90 >,
				<588  231 110 99  98 >,
				<787  246 115 102 96 >,
				<856  251 118 105 101>,
				<895  247 128 118 107>,
				<897  260 129 118 110>,
				<322  246 143 123 110>,
				<869  240 135 126 123>,
				<892  246 117 111 105>,
				<915  250 108 106 97 >,
				<927  255 114 111 105>,
				<943  259 118 115 111>,
				<973  263 114 117 115>,
				<1023 271 121 115 109>,
				<1060 275 123 112 110>,
				<1137 281 123 112 107>,
				<1195 297 109 106 102>,
				<1250 325 120 114 110>,
				<1277 347 122 117 112>,
				<1290 355 132 120 114>,
				<1305 377 130 121 116>,
				<1320 383 132 122 119>,
				<1337 398 100 90  114>,
				<1350 380 95  76  80 >,
				<1369 389 57  100 59 >,
				<1345 400 51  90  40 >,
				<1335 418 104 123 30 >,
				<1296 169 85  119 65>;
	};

	qcom,fcc-temp-lut {
		qcom,lut-col-legend = <(-20) 0 25 40 60>;
		qcom,lut-data = <1512 1705 1850 1850 1820>;
	};

	qcom,pc-temp-ocv-lut {
		qcom,lut-col-legend = <(-20) 0 25 40 60>;
		qcom,lut-row-legend = <100 95 90 85 80>,
				<75 70 65 60 55>,
				<50 45 40 35 30>,
				<25 20 15 10 9>,
				<8 7 6 5 4>,
				<3 2 1 0>;
		qcom,lut-data = <4279 4327 4329 4331 4334>,
				<4200 4201 4260 4266 4270>,
				<4161 4147 4207 4210 4215>,
				<4037 4099 4155 4157 4161>,
				<3981 4058 4085 4088 4110>,
				<3937 3996 4049 4048 4063>,
				<3909 3954 3985 3996 4017>,
				<3882 3917 3958 3963 3975>,
				<3848 3878 3921 3927 3931>,
				<3821 3848 3873 3881 3882>,
				<3811 3824 3837 3842 3843>,
				<3789 3811 3816 3820 3820>,
				<3780 3794 3798 3801 3804>,
				<3766 3782 3782 3787 3789>,
				<3754 3775 3773 3772 3774>,
				<3740 3765 3764 3752 3752>,
				<3721 3742 3739 3734 3730>,
				<3704 3710 3700 3705 3701>,
				<3679 3700 3688 3679 3676>,
				<3660 3696 3684 3677 3675>,
				<3640 3692 3685 3675 3665>,
				<3636 3690 3683 3673 3655>,
				<3610 3675 3680 3670 3600>,
				<3600 3668 3660 3640 3550>,
				<3570 3630 3647 3628 3500>,
				<3548 3600 3571 3555 3450>,
				<3500 3510 3468 3438 3400>,
				<3444 3488 3375 3315 3386>,
				<3000 3000 3000 3000 3000>;
	};
};
