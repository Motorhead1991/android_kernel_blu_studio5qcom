/* Copyright (c) 2013, The Linux Foundation. All rights reserved.
 *
 * This program is free software; you can redistribute it and/or modify
 * it under the terms of the GNU General Public License version 2 and
 * only version 2 as published by the Free Software Foundation.
 *
 * This program is distributed in the hope that it will be useful,
 * but WITHOUT ANY WARRANTY; without even the implied warranty of
 * MERCHANTABILITY or FITNESS FOR A PARTICULAR PURPOSE.  See the
 * GNU General Public License for more details.
 */

/*---------------------------------------------------------------------------
 * This file is autogenerated file using gcdb parser. Please do not edit it.
 * Update input XML file to add a new entry or update variable in this file
 * VERSION = "1.0"
 *---------------------------------------------------------------------------*/
&mdss_mdp {
	ty_5_5inch_boe_nt35517_qhd: qcom,mdss_dsi_ty_5_5_boe_nt35517_qhd_video {
		qcom,mdss-dsi-panel-name = "ty_5_5inch_boe_nt35517_qhd_video dsi panel";
                qcom,cont-splash-enabled;
		qcom,mdss-dsi-panel-controller = <&mdss_dsi0>;
		qcom,mdss-dsi-panel-type = "dsi_video_mode";
		qcom,mdss-dsi-panel-destination = "display_1";
		qcom,mdss-dsi-panel-framerate = <60>;
		qcom,mdss-dsi-virtual-channel-id = <0>;
		qcom,mdss-dsi-stream = <0>;
		qcom,mdss-dsi-panel-width = <540>;
		qcom,mdss-dsi-panel-height = <960>;
		qcom,mdss-dsi-h-front-porch = <32>;
		qcom,mdss-dsi-h-back-porch = <32>;
		qcom,mdss-dsi-h-pulse-width = <4>;
		qcom,mdss-dsi-h-sync-skew = <0>;
		qcom,mdss-dsi-v-back-porch = <16>;
		qcom,mdss-dsi-v-front-porch = <15>;
		qcom,mdss-dsi-v-pulse-width = <1>;
		qcom,mdss-dsi-h-left-border = <0>;
		qcom,mdss-dsi-h-right-border = <0>;
		qcom,mdss-dsi-v-top-border = <0>;
		qcom,mdss-dsi-v-bottom-border = <0>;
		qcom,mdss-dsi-bpp = <24>;
		qcom,mdss-dsi-color-order = <0>;
		qcom,mdss-dsi-underflow-color = <0xff>;
		qcom,mdss-dsi-border-color = <0>;
		qcom,mdss-dsi-on-command = [
39 01 00 00 00 00 06 F0 55 AA 52 08 00 

39 01 00 00 00 00 02 BC 00  

39 01 00 00 00 00 04 CC 03 00 00 

39 01 00 00 00 00 06 B0 00 0C 40 3C 3C   

39 01 00 00 00 00 03 B1 FC 00 

39 01 00 00 00 00 02 B3 80  

39 01 00 00 00 00 02 B6 08 

39 01 00 00 00 00 03 B7 00 00 

39 01 00 00 00 00 02 BA 01  

39 01 00 00 00 00 06 BD 01 41 10 37 01 

39 01 00 00 00 00 06 F0 55 AA 52 08 01  

39 01 00 00 00 00 04 B0 0A 0A 0A  

39 01 00 00 00 00 04 B6 43 43 43 

39 01 00 00 00 00 04 B1 0A 0A 0A  

39 01 00 00 00 00 04 B7 22 22 22  

39 01 00 00 00 00 04 B2 03 03 03  

39 01 00 00 00 00 04 B8 33 33 33   

39 01 00 00 00 00 04 B3 0A 0A 0A 

39 01 00 00 00 00 04 B9 24 24 24  

39 01 00 00 00 00 04 B4 0A 0A 0A  

39 01 00 00 00 00 04 BA 24 24 24  

39 01 00 00 00 00 04 B5 07 07 07   

39 01 00 00 00 00 04 BC 00 70 00 

39 01 00 00 00 00 04 BD 00 70 00 

39 01 00 00 00 00 02 BE 3B  

39 01 00 00 00 00 02 BF 3B                  
                                                                                                                                           
39 01 00 00 00 00 11 D1 00 2D 00 3C 00 56 00 6C 00 7C 00 9B 00 BA 00 E9 

39 01 00 00 00 00 11 D2 01 0F 01 4A 01 79 01 C1 01 FF 02 00 02 37 02 72 

39 01 00 00 00 00 11 D3 02 99 02 CE 02 F6 03 2A 03 4C 03 79 03 97 03 BD 

39 01 00 00 00 00 05 D4 03 F5 03 FF                                                                          

39 01 00 00 00 00 11 D5 00 2D 00 3C 00 56 00 6C 00 7C 00 9B 00 BA 00 E9   

39 01 00 00 00 00 11 D6 01 0F 01 4A 01 79 01 C1 01 FF 02 00 02 37 02 72 

39 01 00 00 00 00 11 D7 02 99 02 CE 02 F6 03 2A 03 4C 03 79 03 97 03 BD 

39 01 00 00 00 00 05 D8 03 F5 03 FF                                                                               

39 01 00 00 00 00 11 D9 00 2D 00 3C 00 56 00 6C 00 7C 00 9B 00 BA 00 E9

39 01 00 00 00 00 11 DD 01 0F 01 4A 01 79 01 C1 01 FF 02 00 02 37 02 72

39 01 00 00 00 00 11 DE 02 99 02 CE 02 F6 03 2A 03 4C 03 79 03 97 03 BD  

39 01 00 00 00 00 05 DF 03 F5 03 FF                                                                             

39 01 00 00 00 00 11 E0 00 2D 00 3C 00 56 00 6C 00 7C 00 9B 00 BA 00 E9   

39 01 00 00 00 00 11 E1 01 0F 01 4A 01 79 01 C1 01 FF 02 00 02 37 02 72 

39 01 00 00 00 00 11 E2 02 99 02 CE 02 F6 03 2A 03 4C 03 79 03 97 03 BD    

39 01 00 00 00 00 05 E3 03 F5 03 FF                                                                            

39 01 00 00 00 00 11 E4 00 2D 00 3C 00 56 00 6C 00 7C 00 9B 00 BA 00 E9 

39 01 00 00 00 00 11 E5 01 0F 01 4A 01 79 01 C1 01 FF 02 00 02 37 02 72 

39 01 00 00 00 00 11 E6 02 99 02 CE 02 F6 03 2A 03 4C 03 79 03 97 03 BD  

39 01 00 00 00 00 05 E7 03 F5 03 FF      
                                                                                              
39 01 00 00 00 00 11 E8 00 2D 00 3C 00 56 00 6C 00 7C 00 9B 00 BA 00 E9 

39 01 00 00 00 00 11 E9 01 0F 01 4A 01 79 01 C1 01 FF 02 00 02 37 02 72 

39 01 00 00 00 00 11 EA 02 99 02 CE 02 F6 03 2A 03 4C 03 79 03 97 03 BD 

39 01 00 00 00 00 05 EB 03 F5 03 FF   
                                                                                                                                         
39 01 00 00 00 00 02 35 00

39 01 00 00 00 00 02 51 FF

39 01 00 00 00 00 02 53 2C 

39 01 00 00 00 00 02 55 02 

05 01 00 00 96 00 02 11 00 	
05 01 00 00 14 00 02 29 00
/*05 01 00 00 14 00 02 2C 00*/
];
		qcom,mdss-dsi-off-command = [
		05 01 00 00 14 00 02 28 00 
		05 01 00 00 96 00 02 10 00 
		];
		qcom,mdss-dsi-on-command-state = "dsi_lp_mode";
		qcom,mdss-dsi-off-command-state = "dsi_lp_mode";
		qcom,mdss-dsi-h-sync-pulse = <0>;
		qcom,mdss-dsi-traffic-mode = "non_burst_sync_event";
		qcom,mdss-dsi-lane-map = "lane_map_3012";
		qcom,mdss-dsi-bllp-eof-power-mode;
		qcom,mdss-dsi-bllp-power-mode;
		qcom,mdss-dsi-lane-0-state;
		qcom,mdss-dsi-lane-1-state;
		qcom,mdss-dsi-panel-timings = [a8 1f 17 00 2f 2d 1c 21 29 03 04 00];
		qcom,mdss-dsi-t-clk-post = <0x20>;
		qcom,mdss-dsi-t-clk-pre = <0x2f>;
		qcom,mdss-dsi-bl-min-level = <1>;
		qcom,mdss-dsi-bl-max-level = <4095>;
		qcom,mdss-dsi-dma-trigger = "trigger_sw";
		qcom,mdss-dsi-mdp-trigger = "none";
		qcom,mdss-dsi-bl-pmic-control-type = "bl_ctrl_wled";
		qcom,mdss-dsi-reset-sequence = <1 20>, <0 10>, <1 20>;
		qcom,mdss-dsi-lp11-init;
		qcom,mdss-dsi-init-delay-us = <50000>;
	};
};
