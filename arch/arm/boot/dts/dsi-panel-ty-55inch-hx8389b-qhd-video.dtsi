/* Copyright (c) 2013, The Linux Foundation. All rights reserved.
 *
 * This program is free software; you can redistribute it and/or modify
 * it under the terms of the GNU General Public License version 2 and
 * only version 2 as published by the Free Software Foundation.
 *
 * This program is distributed in the hope that it will be useful,
 * but WITHOUT ANY WARRANTY; without even the implied warranty of
 * MERCHANTABILITY or FITNESS FOR A PARTICULAR PURPOSE.  See the
 * GNU General Public License for more details.
 */

/*---------------------------------------------------------------------------
 * This file is autogenerated file using gcdb parser. Please do not edit it.
 * Update input XML file to add a new entry or update variable in this file
 * VERSION = "1.0"
 *---------------------------------------------------------------------------*/
&mdss_mdp {
	ty_5_5inch_truly_hx8389b_qhd: qcom,mdss_dsi_ty_5_5inch_truly_hx8389b_qhd_video {
		qcom,mdss-dsi-panel-name = "ty_5_5inch_truly_hx8389b_qhd_video dsi panel";
                qcom,cont-splash-enabled;
		qcom,mdss-dsi-panel-controller = <&mdss_dsi0>;
		qcom,mdss-dsi-panel-type = "dsi_video_mode";
		qcom,mdss-dsi-panel-destination = "display_1";
		qcom,mdss-dsi-panel-framerate = <60>;
		qcom,mdss-dsi-virtual-channel-id = <0>;
		qcom,mdss-dsi-stream = <0>;
		qcom,mdss-dsi-panel-width = <540>;
		qcom,mdss-dsi-panel-height = <960>;
		qcom,mdss-dsi-h-front-porch = <32>;
		qcom,mdss-dsi-h-back-porch = <32>;
		qcom,mdss-dsi-h-pulse-width = <4>;
		qcom,mdss-dsi-h-sync-skew = <0>;
		qcom,mdss-dsi-v-back-porch = <10>;
		qcom,mdss-dsi-v-front-porch = <15>;
		qcom,mdss-dsi-v-pulse-width = <1>;
		qcom,mdss-dsi-h-left-border = <0>;
		qcom,mdss-dsi-h-right-border = <0>;
		qcom,mdss-dsi-v-top-border = <0>;
		qcom,mdss-dsi-v-bottom-border = <0>;
		qcom,mdss-dsi-bpp = <24>;
		qcom,mdss-dsi-color-order = <0>;
		qcom,mdss-dsi-underflow-color = <0xff>;
		qcom,mdss-dsi-border-color = <0>;
		qcom,mdss-dsi-on-command = [
 39 01 00 00 00 00 04 B9 FF 83 89

 39 01 00 00 00 00 03 DE 05 58

 39 01 00 00 00 00 03 BA 41 93

 39 01 00 00 00 00 14 B1 00 00 04 E5 9C 00 00 AF EF 0C 14 16 16 43 00 58 F7 20 00

 39 01 00 00 00 00 08 B2 00 00 78 08 03 3F 20
                                                            
 39 01 00 00 00 00 18 B4 80 08 00 32 10 00 00 00 00 00 00 00 37 0A 40 04 37 0A 40 14 FF FF 0A
 39 01 00 00 00 00 02 CC 02
 39 01 00 00 00 00 05 B6 00 98 00 98
 39 01 00 00 00 00 03 CB 07 07
 39 01 00 00 00 00 05 BB 00 00 FF 80

 39 01 00 00 00 00 34
 D5 00 00 4C 00 01 00 00 00 60 00 99
 88 99 BB 88 23 88 01 88 67 88 45 01 32 88 88 88
 88 88 88 99 AA BB 88 54 88 76 88 10 88 32 32 10
 88 88 88 88 88 01 02 ff

 39 01 00 00 00 00 23
 E0 00 00 00 3F 38 38 08 29 07 0C 0D
 11 13 11 14 0F 18 00 00 00 3F 38 38 08 29 07 0C
 0D 11 13 11 14 0F 18
 39 01 00 00 00 00 02 36 01

 39 01 00 00 00 00 80
 C1 01 00 0E 17 1C 24 2A 30 36 40 49
 51 58 5F 67 6F 77 80 87 8F 98 9F A6 AD B6 BD C6
 CD D4 DE E6 F0 F7 FF 3F 3A 01 81 60 5C 92 63 C0
 00 0E 17 1C 24 2A 30 36 40 49 51 58 5F 67 6F 77
 80 87 8F 98 9F A6 AD B6 BD C6 CD D4 DE E6 F0 F7
 FF 3F 3A 01 81 60 5C 92 63 C0 00 0E 17 1C 24 2A
 30 36 40 49 51 58 5F 67 6F 77 80 87 8F 98 9F A6
 AD B6 BD C6 CD D4 DE E6 F0 F7 FF 3F 3A 01 81 60
 5C 92 63 C0
 05 01 00 00 96 00 02 11 00 
 05 01 00 00 14 00 02 29 00];
		qcom,mdss-dsi-off-command = [
		05 01 00 00 14 00 02 28 00 
		05 01 00 00 96 00 02 10 00 
		];
		qcom,mdss-dsi-on-command-state = "dsi_lp_mode";
		qcom,mdss-dsi-off-command-state = "dsi_lp_mode";
		qcom,mdss-dsi-h-sync-pulse = <0>;
		qcom,mdss-dsi-traffic-mode = "non_burst_sync_event";
		qcom,mdss-dsi-lane-map = "lane_map_3012";
		qcom,mdss-dsi-bllp-eof-power-mode;
		qcom,mdss-dsi-bllp-power-mode;
		qcom,mdss-dsi-lane-0-state;
		qcom,mdss-dsi-lane-1-state;
		qcom,mdss-dsi-panel-timings = [a8 1f 17 00 2f 2d 1c 21 29 03 04 00];
		qcom,mdss-dsi-t-clk-post = <0x20>;
		qcom,mdss-dsi-t-clk-pre = <0x2f>;
		qcom,mdss-dsi-bl-min-level = <1>;
		qcom,mdss-dsi-bl-max-level = <4095>;
		qcom,mdss-dsi-dma-trigger = "trigger_sw";
		qcom,mdss-dsi-mdp-trigger = "none";
		qcom,mdss-dsi-bl-pmic-control-type = "bl_ctrl_wled";
		qcom,mdss-dsi-reset-sequence = <1 20>, <0 10>, <1 20>;
		qcom,mdss-dsi-lp11-init;
		qcom,mdss-dsi-init-delay-us = <50000>;
	};
};
