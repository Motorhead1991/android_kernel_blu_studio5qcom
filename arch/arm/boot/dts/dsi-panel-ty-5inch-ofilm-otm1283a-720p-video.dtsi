/* Copyright (c) 2013, The Linux Foundation. All rights reserved.
 *
 * This program is free software; you can redistribute it and/or modify
 * it under the terms of the GNU General Public License version 2 and
 * only version 2 as published by the Free Software Foundation.
 *
 * This program is distributed in the hope that it will be useful,
 * but WITHOUT ANY WARRANTY; without even the implied warranty of
 * MERCHANTABILITY or FITNESS FOR A PARTICULAR PURPOSE.  See the
 * GNU General Public License for more details.
 */

/*---------------------------------------------------------------------------
 * This file is autogenerated file using gcdb parser. Please do not edit it.
 * Update input XML file to add a new entry or update variable in this file
 * VERSION = "1.0"
 *---------------------------------------------------------------------------*/
&mdss_mdp {
	dsi_ofilm_otm1283a_720p_vid: qcom,mdss_dsi_ofilm_otm1283a_720p_video {
		qcom,mdss-dsi-panel-name = "ofilm otm1283a 720p video mode dsi panel";
 		qcom,cont-splash-enabled;
		qcom,mdss-dsi-panel-controller = <&mdss_dsi0>;
		qcom,mdss-dsi-panel-type = "dsi_video_mode";
		qcom,mdss-dsi-panel-destination = "display_1";
		qcom,mdss-dsi-panel-framerate = <60>;
		qcom,mdss-dsi-virtual-channel-id = <0>;
		qcom,mdss-dsi-stream = <0>;
		qcom,mdss-dsi-panel-width = <720>;
		qcom,mdss-dsi-panel-height = <1280>;
		qcom,mdss-dsi-h-front-porch = <80>;
		qcom,mdss-dsi-h-back-porch = <24>;
		qcom,mdss-dsi-h-pulse-width = <14>;
		qcom,mdss-dsi-h-sync-skew = <0>;
		qcom,mdss-dsi-v-back-porch = <14>;
		qcom,mdss-dsi-v-front-porch = <25>;
		qcom,mdss-dsi-v-pulse-width = <2>;
		qcom,mdss-dsi-h-left-border = <0>;
		qcom,mdss-dsi-h-right-border = <0>;
		qcom,mdss-dsi-v-top-border = <0>;
		qcom,mdss-dsi-v-bottom-border = <0>;
		qcom,mdss-dsi-bpp = <24>;
		qcom,mdss-dsi-color-order = <0>;
		qcom,mdss-dsi-underflow-color = <0xff>;
		qcom,mdss-dsi-border-color = <0>;
		qcom,mdss-dsi-on-command = [
			29 01 00 00 00 00 02 00 00
			29 01 00 00 00 00 04 FF 12 83 01
			29 01 00 00 00 00 02 00 80
			29 01 00 00 00 00 03 FF 12 83
			29 01 00 00 00 00 02 00 A2
			29 01 00 00 00 00 02 C1 08
			29 01 00 00 00 00 02 00 A4
			29 01 00 00 00 00 02 C1 F0
			29 01 00 00 00 00 02 00 80
			29 01 00 00 00 00 02 C4 30
			29 01 00 00 00 00 02 00 8A
			29 01 00 00 00 00 02 C4 40
			29 01 00 00 00 00 02 00 80
			29 01 00 00 00 00 0A C0 00 64 00 0F 11 00 64 0F 11
			29 01 00 00 00 00 02 00 90
			29 01 00 00 00 00 07 C0 00 55 00 01 00 04
			29 01 00 00 00 00 02 00 A4
			29 01 00 00 00 00 02 C0 00
			29 01 00 00 00 00 02 00 B3
			29 01 00 00 00 00 03 C0 00 50
			29 01 00 00 00 00 02 00 81
			29 01 00 00 00 00 02 C1 66
			29 01 00 00 00 00 02 00 80
			29 01 00 00 0A 00 02 C4 30
			29 01 00 00 00 00 02 00 81
			29 01 00 00 00 00 03 C4 83 02
			29 01 00 00 00 00 02 00 90
			29 01 00 00 00 00 02 C4 49
			29 01 00 00 00 00 02 00 B9
			29 01 00 00 00 00 02 B0 51
			29 01 00 00 00 00 02 00 C6
			29 01 00 00 00 00 02 B0 03
			29 01 00 00 00 00 02 00 A4
			29 01 00 00 00 00 02 C0 00
			29 01 00 00 00 00 02 00 87
			29 01 00 00 00 00 02 C4 18
			29 01 00 00 00 00 02 00 B0
			29 01 00 00 00 00 02 C6 03
			29 01 00 00 00 00 02 00 90
			29 01 00 00 00 00 05 F5 02 11 02 11
			29 01 00 00 00 00 02 00 90
			29 01 00 00 00 00 02 C5 50
			29 01 00 00 00 00 02 00 94
			29 01 00 00 00 00 02 C5 66
			29 01 00 00 00 00 02 00 B2
			29 01 00 00 00 00 09 F5 00 00 00 00 00 00 00 00
			29 01 00 00 00 00 02 00 94
			29 01 00 00 00 00 02 F5 02
			29 01 00 00 00 00 02 00 BA
			29 01 00 00 00 00 02 F5 03
			29 01 00 00 00 00 02 00 B4
			29 01 00 00 00 00 02 C5 C0
			29 01 00 00 00 00 02 00 A0
			29 01 00 00 00 00 0F C4 05 10 04 02 05 15 11 05 10 07 02 05 15 11
			29 01 00 00 00 00 02 00 B0
			29 01 00 00 00 00 03 C4 66 66
			29 01 00 00 00 00 02 00 91
			29 01 00 00 00 00 03 C5 19 50
			29 01 00 00 00 00 02 00 B0
			29 01 00 00 00 00 03 C5 04 B8
			29 01 00 00 00 00 02 00 B5
			29 01 00 00 00 00 09 C5 03 E8 40 03 E8 40 80 00
			29 01 00 00 00 00 02 00 80
			29 01 00 00 00 00 0C CB 00 00 00 00 00 00 00 00 00 00 00
			29 01 00 00 00 00 02 00 90
			29 01 00 00 00 00 10 CB 00 00 00 00 00 00 00 00 00 00 00 FF 00 FF 00
			29 01 00 00 00 00 02 00 A0
			29 01 00 00 00 00 10 CB FF 00 FF 00 00 00 00 00 00 00 00 00 00 00 00
			29 01 00 00 00 00 02 00 B0
			29 01 00 00 00 00 10 CB 00 00 00 FF 00 FF 00 FF 00 FF 00 00 00 00 00
			29 01 00 00 00 00 02 00 C0
			29 01 00 00 00 00 10 CB 00 00 00 00 00 00 00 00 00 00 00 05 00 05 05
			29 01 00 00 00 00 02 00 D0
			29 01 00 00 00 00 10 CB 05 05 05 00 00 00 00 00 00 00 00 00 00 00 00
			29 01 00 00 00 00 02 00 E0
			29 01 00 00 00 00 0F CB 00 00 00 05 00 05 05 05 05 05 00 00 00 00
			29 01 00 00 00 00 02 00 F0
			29 01 00 00 00 00 0C CB FF FF FF FF FF FF FF FF FF FF FF
			29 01 00 00 00 00 02 00 80
			29 01 00 00 00 00 10 CC 00 00 00 00 00 00 00 00 00 00 00 0A 00 10 0E
			29 01 00 00 00 00 02 00 90
			29 01 00 00 00 00 10 CC 0C 02 04 00 00 00 00 00 00 00 00 00 00 00 00
			29 01 00 00 00 00 02 00 A0
			29 01 00 00 00 00 0F CC 00 00 00 09 00 0F 0D 0B 01 03 00 00 00 00
			29 01 00 00 00 00 02 00 B0
			29 01 00 00 00 00 10 CC 00 00 00 00 00 00 00 00 00 00 00 0A 00 10 0E
			29 01 00 00 00 00 02 00 C0
			29 01 00 00 00 00 10 CC 0C 02 04 00 00 00 00 00 00 00 00 00 00 00 00
			29 01 00 00 00 00 02 00 D0
			29 01 00 00 00 00 0F CC 00 00 00 09 00 0F 0D 0B 01 03 00 00 00 00
			29 01 00 00 00 00 02 00 80
			29 01 00 00 00 00 0D CE 87 03 06 86 03 06 85 03 06 84 03 06
			29 01 00 00 00 00 02 00 90
			29 01 00 00 00 00 0F CE F0 00 00 F0 00 00 F0 00 00 F0 00 00 00 00
			29 01 00 00 00 00 02 00 A0
			29 01 00 00 00 00 0F CE 38 05 84 FE 00 06 00 38 04 84 FF 00 06 00
			29 01 00 00 00 00 02 00 B0
			29 01 00 00 00 00 0F CE 38 03 85 00 00 06 00 38 02 85 01 00 06 00
			29 01 00 00 00 00 02 00 C0
			29 01 00 00 00 00 0F CE 38 01 85 02 00 06 00 38 00 85 03 00 06 00
			29 01 00 00 00 00 02 00 D0
			29 01 00 00 00 00 0F CE 30 00 85 04 00 06 00 30 01 85 05 00 06 00
			29 01 00 00 00 00 02 00 80
			29 01 00 00 00 00 0F CF 70 00 00 10 00 00 00 70 00 00 10 00 00 00
			29 01 00 00 00 00 02 00 90
			29 01 00 00 00 00 0F CF 70 00 00 10 00 00 00 70 00 00 10 00 00 00
			29 01 00 00 00 00 02 00 A0
			29 01 00 00 00 00 0F CF 70 00 00 10 00 00 00 70 00 00 10 00 00 00
			29 01 00 00 00 00 02 00 B0
			29 01 00 00 00 00 0F CF 70 00 00 10 00 00 00 70 00 00 10 00 00 00
			29 01 00 00 00 00 02 00 C0
			29 01 00 00 00 00 0C CF 01 01 20 20 00 00 01 80 00 03 08
			29 01 00 00 00 00 02 00 00
			29 01 00 00 00 00 03 D8 BC BC
			29 01 00 00 00 00 02 00 00
			29 01 00 00 00 00 02 D9 9A
			29 01 00 00 00 00 02 00 00
			29 01 00 00 00 00 11 E1 04 09 0E 0D 06 0F 0A 09 04 07 0D 07 0E 16 10 0A
			29 01 00 00 00 00 02 00 00
			29 01 00 00 00 00 11 E2 04 09 0F 0D 06 0F 0A 09 04 07 0D 07 0E 16 10 0A
			29 01 00 00 00 00 02 00 00
			29 01 00 00 00 00 04 FF FF FF FF
			29 01 00 00 00 00 02 35 00
			05 01 00 00 78 00 02 11 00
			05 01 00 00 78 00 02 29 00];

		qcom,mdss-dsi-off-command = [05 01 00 00 32 00 02 28 00
					05 01 00 00 78 00 02 10 00];

		qcom,mdss-dsi-on-command-state = "dsi_lp_mode";
		qcom,mdss-dsi-off-command-state = "dsi_hs_mode";
		qcom,mdss-dsi-h-sync-pulse = <1>;
		qcom,mdss-dsi-traffic-mode = <2>;
		qcom,mdss-dsi-lane-map = <0>;
		qcom,mdss-dsi-bllp-eof-power-mode;
		qcom,mdss-dsi-lane-0-state;
		qcom,mdss-dsi-lane-1-state;
		qcom,mdss-dsi-lane-2-state;
		qcom,mdss-dsi-lane-3-state;
		qcom,mdss-dsi-panel-timings = [59 1F 17 00 2F 2D 1C 21 29 03 04 00];
		qcom,mdss-dsi-t-clk-post = <0x20>;
		qcom,mdss-dsi-t-clk-pre = <0x2f>;
		qcom,mdss-dsi-bl-min-level = <1>;
		qcom,mdss-dsi-bl-max-level = <4095>;
		qcom,mdss-dsi-dma-trigger = <4>;
		qcom,mdss-dsi-mdp-trigger = <0>;
		qcom,mdss-dsi-bl-pmic-control-type = "bl_ctrl_wled";
		qcom,mdss-dsi-reset-sequence = <1 20>, <0 1>, <1 20>;
	};
};
