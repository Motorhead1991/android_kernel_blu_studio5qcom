/* Copyright (c) 2013, The Linux Foundation. All rights reserved.
 *
 * This program is free software; you can redistribute it and/or modify
 * it under the terms of the GNU General Public License version 2 and
 * only version 2 as published by the Free Software Foundation.
 *
 * This program is distributed in the hope that it will be useful,
 * but WITHOUT ANY WARRANTY; without even the implied warranty of
 * MERCHANTABILITY or FITNESS FOR A PARTICULAR PURPOSE.  See the
 * GNU General Public License for more details.
 */

/*---------------------------------------------------------------------------
 * This file is autogenerated file using gcdb parser. Please do not edit it.
 * Update input XML file to add a new entry or update variable in this file
 * VERSION = "1.0"
 *---------------------------------------------------------------------------*/
&mdss_mdp {
	dsi_ty_hx8389b_trulylg_qhd_vid: qcom,mdss_dsi_ty_hx8389b_trulylg_qhd_video {
		qcom,mdss-dsi-panel-name = "ty_hx8389b qhd truly lg video mode dsi panel";
                qcom,cont-splash-enabled;
		qcom,mdss-dsi-panel-controller = <&mdss_dsi0>;
		qcom,mdss-dsi-panel-type = "dsi_video_mode";
		qcom,mdss-dsi-panel-destination = "display_1";
		qcom,mdss-dsi-panel-framerate = <58>;
		qcom,mdss-dsi-virtual-channel-id = <0>;
		qcom,mdss-dsi-stream = <0>;
		qcom,mdss-dsi-panel-width = <540>;
		qcom,mdss-dsi-panel-height = <960>;
		qcom,mdss-dsi-h-front-porch = <45>;
		qcom,mdss-dsi-h-back-porch = <66>;
		qcom,mdss-dsi-h-pulse-width = <5>;
		qcom,mdss-dsi-h-sync-skew = <0>;
		qcom,mdss-dsi-v-front-porch = <5>;
		qcom,mdss-dsi-v-back-porch = <9>;
		qcom,mdss-dsi-v-pulse-width = <2>;
		qcom,mdss-dsi-h-left-border = <0>;
		qcom,mdss-dsi-h-right-border = <0>;
		qcom,mdss-dsi-v-top-border = <0>;
		qcom,mdss-dsi-v-bottom-border = <0>;
		qcom,mdss-dsi-bpp = <24>;
		qcom,mdss-dsi-color-order = "rgb_swap_rgb";
		qcom,mdss-dsi-underflow-color = <0xff>;
		qcom,mdss-dsi-border-color = <0>;
		qcom,mdss-dsi-pixel-packing = "tight";
		qcom,mdss-dsi-on-command = [
39 01 00 00 00 00 04 B9 FF 83 89 
39 01 00 00 00 00 03 DE 05 58 
39 01 00 00 00 00 08 BA 41 93 00 16 A4 10 18 
39 01 00 00 00 00 14 B1 00 00 05 E0 9a 10 11 6F EF 25 2D 22 22 43 00 5A F0 20 80 
39 01 00 00 00 00 08 B2 00 00 78 05 07 3F 80
39 01 00 00 00 00 18 B4 90 08 00 32 10 00 00 00 00 00 00 00 37 0A 40 04 37 0A 48 1A FF 61 0A 
39 01 00 00 00 00 1e D5 00 00 4C 00 01 00 00 00 60 00 99 88 99 88 88 32 88 10 88 76 88 54 10 32 88 88 88 88 88 
39 01 00 00 00 00 23 E0 03 0D 11 27 2B 3F 19 35 06 0D 0F 12 14 11 14 10 18 03 0D 11 27 2B 3F 19 35 06 0D 0F 12 14 11 14 10 18 
39 01 00 00 00 00 04 B7 00 00 50			
39 01 00 00 00 00 80 C1 00 00 07 1C 2A 34 3F 49 52 5B 63 6A 71 78 7F 85 8B 91 97 9D A3 A8 AF B5 BE C6 C9 CD D7 E1 E6 F1 F7 FF 34 CB 4F D9 54 C8 3C 4A C0 00 07 1C 2A 34 3F 49 52 5B 63 6A 71 78 7F 85 8B 91 97 9D A3 A8 AF B5 BE C6 C9 CD D7 E1 E6 F1 F7 FF 34 CB 4F D9 54 C8 3C 4A C0 00 07 1C 2A 34 3F 49 52 5B 63 6A 71 78 7F 85 8B 91 97 9D A3 A8 AF B5 BE C6 C9 CD D7 E1 E6 F1 F7 FF 34 CB 4F D9 54 C8 3C 4A C0 
15 01 00 00 01 00 02 C6 08 
15 01 00 00 01 00 02 CC 02 
39 01 00 00 00 00 05 B6 00 A1 00 A1 
39 01 00 00 00 00 03 CB 07 07 
39 01 00 00 00 00 05 BB 00 00 FF 80 
05 01 00 00 78 00 02 11 00
05 01 00 00 32 00 02 29 00];
		qcom,mdss-dsi-off-command = [
		05 01 00 00 32 00 02 28 00 
		05 01 00 00 78 00 02 10 00 
		];
		qcom,mdss-dsi-on-command-state = "dsi_lp_mode";
		qcom,mdss-dsi-off-command-state = "dsi_lp_mode";
		qcom,mdss-dsi-h-sync-pulse = <0>;
		qcom,mdss-dsi-traffic-mode = "non_burst_sync_event";
		qcom,mdss-dsi-lane-map = "lane_map_3012";
		qcom,mdss-dsi-bllp-eof-power-mode;
		qcom,mdss-dsi-lane-0-state;
		qcom,mdss-dsi-lane-1-state;
		qcom,mdss-dsi-panel-timings = [a8 1f 17 00 2f 2d 1c 21 29 03 04 00];
		qcom,mdss-dsi-t-clk-post = <0x20>;
		qcom,mdss-dsi-t-clk-pre = <0x2f>;
		qcom,mdss-dsi-bl-min-level = <1>;
		qcom,mdss-dsi-bl-max-level = <4095>;
		qcom,mdss-dsi-dma-trigger = "trigger_sw";
		qcom,mdss-dsi-mdp-trigger = "none";
		qcom,mdss-dsi-bl-pmic-control-type = "bl_ctrl_wled";
		qcom,mdss-dsi-reset-sequence = <1 20>, <0 2>, <1 20>;
		qcom,mdss-dsi-lp11-init;
		qcom,mdss-dsi-init-delay-us = <50000>;
	};
};
