/* Copyright (c) 2013, The Linux Foundation. All rights reserved.
 *
 * This program is free software; you can redistribute it and/or modify
 * it under the terms of the GNU General Public License version 2 and
 * only version 2 as published by the Free Software Foundation.
 *
 * This program is distributed in the hope that it will be useful,
 * but WITHOUT ANY WARRANTY; without even the implied warranty of
 * MERCHANTABILITY or FITNESS FOR A PARTICULAR PURPOSE.  See the
 * GNU General Public License for more details.

 */

/*---------------------------------------------------------------------------
 * This file is autogenerated file using gcdb parser. Please do not edit it.
 * Update input XML file to add a new entry or update variable in this file
 * VERSION = "1.0"
 *---------------------------------------------------------------------------*/
&mdss_mdp {
	dsi_ty_5_5_inch_ofilm_otm9605a_qhd_vid: qcom,mdss_dsi_ty_5_5_inch_ofilm_otm9605a_qhd_video {
		qcom,mdss-dsi-panel-name = "5.5 inch ofilm_otm9605a qhd video mode dsi panel";
                qcom,cont-splash-enabled;
		qcom,mdss-dsi-panel-controller = <&mdss_dsi0>;
		qcom,mdss-dsi-panel-type = "dsi_video_mode";
		qcom,mdss-dsi-panel-destination = "display_1";
		qcom,mdss-dsi-panel-framerate = <60>;
		qcom,mdss-dsi-virtual-channel-id = <0>;
		qcom,mdss-dsi-stream = <0>;
		qcom,mdss-dsi-panel-width = <540>;
		qcom,mdss-dsi-panel-height = <960>;
		qcom,mdss-dsi-h-front-porch = <32>;
		qcom,mdss-dsi-h-back-porch = <32>;
		qcom,mdss-dsi-h-pulse-width = <4>;
		qcom,mdss-dsi-h-sync-skew = <0>;
		qcom,mdss-dsi-v-back-porch = <16>;
		qcom,mdss-dsi-v-front-porch = <15>;
		qcom,mdss-dsi-v-pulse-width = <1>;
		qcom,mdss-dsi-h-left-border = <0>;
		qcom,mdss-dsi-h-right-border = <0>;
		qcom,mdss-dsi-v-top-border = <0>;
		qcom,mdss-dsi-v-bottom-border = <0>;
		qcom,mdss-dsi-bpp = <24>;
		qcom,mdss-dsi-color-order = <0>;
		qcom,mdss-dsi-underflow-color = <0xff>;
		qcom,mdss-dsi-border-color = <0>;
		qcom,mdss-dsi-on-command = [      
                    39 01 00 00 00 00 02 00 00
                      39 01 00 00 00 00 04 FF 96 05 01
  
                      39 01 00 00 00 00 02 00 80
                      39 01 00 00 00 00 03 FF 96 05
  
                      39 01 00 00 00 00 02 00 92
                      39 01 00 00 00 00 03 FF 10 02
  
                      39 01 00 00 00 00 02 00 00
                      39 01 00 00 00 00 02 00 00
                      39 01 00 00 00 00 02 00 00
                      39 01 00 00 00 00 02 00 00
                      39 01 00 00 00 00 02 00 00
                      39 01 00 00 00 00 02 00 00
                      39 01 00 00 00 00 02 00 00
                      39 01 00 00 00 00 02 00 00

                      39 01 00 00 00 00 02 00 B4  
                      39 01 00 00 00 00 03 C0 50 58


  
                       39 01 00 00 00 00 02 00 80
                       39 01 00 00 00 00 03 C1 36 66
  
                       39 01 00 00 00 00 02 00 89
                       39 01 00 00 00 00 02 C0 01
  
                       39 01 00 00 00 00 02 00 A0
                       39 01 00 00 00 00 02 C1 02

                       39 01 00 00 00 00 02 00 80
                       39 01 00 00 00 00 05 C5 08 00 A0 11

                       39 01 00 00 00 00 02 00 90
                       39 01 00 00 00 00 04 C5 96 59 01

                       39 01 00 00 00 00 02 00 B0
                       39 01 00 00 00 00 03 C5 05 28
    
                       39 01 00 00 00 00 02 00 00
                       39 01 00 00 00 00 03 D8 77 77 

                       39 01 00 00 00 00 02 00 00 
                       39 01 00 00 00 00 02 D9 3B 

                       39 01 00 00 00 00 02 00 A6 
                       39 01 00 00 00 00 02 C1 01

                       39 01 00 00 00 00 02 00 A2
                       39 01 00 00 00 00 04 C0 0C 05 02

                       39 01 00 00 00 00 02 00 80
                       39 01 00 00 00 00 0B CB 00 00 00 00 00 00 00 00 00 00                              
  
                       39 01 00 00 00 00 02 00 90
                       39 01 00 00 00 00 10 CB 00 00 00 00 00 00 00 00 00 00 00 00 00 00 00    
  
                       39 01 00 00 00 00 02 00 A0                                                                           
                       39 01 00 00 00 00 10 CB 00 00 00 00 00 00 00 00 00 00 00 00 00 00 00    
  
                       39 01 00 00 00 00 02 00 B0 
                       39 01 00 00 00 00 0B CB 00 00 00 00 00 00 00 00 00 00                             

                       39 01 00 00 00 00 02 00 C0  
                       39 01 00 00 00 00 10 CB 04 04 04 04 08 04 08 04 08 04 08 04 04 04 08    

                       39 01 00 00 00 00 02 00 D0 
                       39 01 00 00 00 00 10 CB 08 00 00 00 00 04 04 04 04 08 04 08 04 08 04    
  
                       39 01 00 00 00 00 02 00 E0 
                       39 01 00 00 00 00 0B CB 08 04 04 04 08 08 00 00 00 00

                       39 01 00 00 00 00 02 00 F0 
                       39 01 00 00 00 00 0B CB FF FF FF FF FF FF FF FF FF FF

                       39 01 00 00 00 00 02 00 80
                       39 01 00 00 00 00 0B CC 26 25 21 22 00 10 00 0E 00 0C
                               
                       39 01 00 00 00 00 02 00 90
                       39 01 00 00 00 00 10 CC 00 0A 02 04 00 00 00 00 00 00 26 25 21 22 00 
     
                       39 01 00 00 00 00 02 00 A0
                       39 01 00 00 00 00 10 CC 0F 00 0D 00 0B 00 09 01 03 00 00 00 00 00 00
                      39 01 00 00 00 00 02 00 b0
                      39 01 00 00 00 00 0B CC 25 26 22 21 00 09 00 0b 00 0d
                      39 01 00 00 00 00 02 00 c0
                      39 01 00 00 00 00 10 CC 00 0f 03 01 00 00 00 00 00 00 25 26 22 21 00
                      39 01 00 00 00 00 02 00 d0
                      39 01 00 00 00 00 10 CC 0a 00 0c 00 0e 00 10 04 02 00 00 00 00 00 00

                       39 01 00 00 00 00 02 00 80                                                                      
                       39 01 00 00 00 00 0D CE 8B 03 06 8A 03 06 89 03 06 88 03 06                  
  
                       39 01 00 00 00 00 02 00 90
                       39 01 00 00 00 00 0F CE F0 00 00 F0 00 00 F0 00 00 F0 00 00 00 00         
  
                       39 01 00 00 00 00 02 00 A0
                       39 01 00 00 00 00 0F CE 38 03 03 C0 00 06 00 38 02 03 C1 00 06 00
                
                       39 01 00 00 00 00 02 00 B0  
                       39 01 00 00 00 00 0F CE 38 01 03 C2 00 06 00 38 00 03 C3 00 06 00
                    
                       39 01 00 00 00 00 02 00 C0                                                                      
                       39 01 00 00 00 00 0F CE 38 07 03 BC 00 06 00 38 06 03 BD 00 06 00         
  
                       39 01 00 00 00 00 02 00 D0                                                                      
                       39 01 00 00 00 00 0F CE 38 05 03 BE 00 06 00 38 04 03 BF 00 06 00         

                       39 01 00 00 00 00 02 00 80                                                                      
                       39 01 00 00 00 00 0F CF F0 00 00 10 00 00 00 F0 00 00 10 00 00 00          
  
                       39 01 00 00 00 00 02 00 90                                                                       
                       39 01 00 00 00 00 0F CF F0 00 00 10 00 00 00 F0 00 00 10 00 00 00          
  
                       39 01 00 00 00 00 02 00 A0
                       39 01 00 00 00 00 0F CF F0 00 00 10 00 00 00 F0 00 00 10 00 00 00         
  
                       39 01 00 00 00 00 02 00 B0
                       39 01 00 00 00 00 0F CF F0 00 00 10 00 00 00 F0 00 00 10 00 00 00         
  
                       39 01 00 00 00 00 02 00 C0                                                                       
                       39 01 00 00 00 00 0B CF 02 02 20 20 00 00 01 02 00 02

                       39 01 00 00 00 00 02 00 00
                       39 01 00 00 00 00 11 E1 04 0c 11 0d 06 0e 0b 0a 04 07 0e 08 0F 14 0b 05                                         

                       39 01 00 00 00 00 02 00 00
                       39 01 00 00 00 00 11 E2 04 0b 11 0e 07 0e 0b 09 04 08 0e 08 0F 14 0b 05

                      39 01 00 00 00 00 02 00 B1
                      39 01 00 00 00 00 02 C5 28

                      39 01 00 00 00 00 02 00 80
                      39 01 00 00 00 00 02 C4 9C

                      39 01 00 00 00 00 02 00 87
                      39 01 00 00 00 00 02 C4 40

                      39 01 00 00 00 00 02 00 C0
                      39 01 00 00 00 00 02 C5 00

                      39 01 00 00 00 00 02 00 B2
                      39 01 00 00 00 00 05 F5 15 00 15 00

                      39 01 00 00 00 00 02 00 93
                      39 01 00 00 00 00 02 C5 03

                      39 01 00 00 00 00 02 00 80
                      39 01 00 00 00 00 03 C1 36 66

                      39 01 00 00 00 00 02 00 89
                      39 01 00 00 00 00 02 C0 01

                      39 01 00 00 00 00 02 00 A0
                      39 01 00 00 00 00 02 C1 00

                      39 01 00 00 00 00 02 00 C5
                      39 01 00 00 00 00 02 B0 03

                      39 01 00 00 00 00 02 00 00
                      39 01 00 00 00 00 04 ff ff ff ff

                      05 01 00 00 96 00 02 11 00
                      05 01 00 00 78 00 02 29 00];
		qcom,mdss-dsi-off-command = [
		                    05 01 00 00 32 00 02 28 00 
                       		05 01 00 00 78 00 02 10 00 
		]; 
		qcom,mdss-dsi-on-command-state = "dsi_lp_mode";
		qcom,mdss-dsi-off-command-state = "dsi_lp_mode";
		qcom,mdss-dsi-h-sync-pulse = <0>;
		qcom,mdss-dsi-traffic-mode = "non_burst_sync_event";
		qcom,mdss-dsi-lane-map = "lane_map_3012";
		qcom,mdss-dsi-bllp-eof-power-mode;
		qcom,mdss-dsi-bllp-power-mode;
		qcom,mdss-dsi-lane-0-state;
		qcom,mdss-dsi-lane-1-state;
		qcom,mdss-dsi-panel-timings = [a8 1f 17 00 2f 2d 1c 21 29 03 04 00];
		qcom,mdss-dsi-t-clk-post = <0x20>;
		qcom,mdss-dsi-t-clk-pre = <0x2f>;
		qcom,mdss-dsi-bl-min-level = <1>;
		qcom,mdss-dsi-bl-max-level = <4095>;
		qcom,mdss-dsi-dma-trigger = "trigger_sw";
		qcom,mdss-dsi-mdp-trigger = "none";
		qcom,mdss-dsi-bl-pmic-control-type = "bl_ctrl_wled";
		qcom,mdss-dsi-reset-sequence = <1 20>, <0 10>, <1 20>;
		qcom,mdss-dsi-lp11-init;
		qcom,mdss-dsi-init-delay-us = <50000>;
	};
};
