/* Copyright (c) 2013, The Linux Foundation. All rights reserved.
 *
 * This program is free software; you can redistribute it and/or modify
 * it under the terms of the GNU General Public License version 2 and
 * only version 2 as published by the Free Software Foundation.
 *
 * This program is distributed in the hope that it will be useful,
 * but WITHOUT ANY WARRANTY; without even the implied warranty of
 * MERCHANTABILITY or FITNESS FOR A PARTICULAR PURPOSE.  See the
 * GNU General Public License for more details.
 */

/*---------------------------------------------------------------------------
 * This file is autogenerated file using gcdb parser. Please do not edit it.
 * Update input XML file to add a new entry or update variable in this file
 * VERSION = "1.0"
 *---------------------------------------------------------------------------*/
&mdss_mdp {
	dsi_ty_truly_hx8379a_fwvga_vid: qcom,mdss_dsi_ty_truly_hx8379a_fwvga_video {
		qcom,mdss-dsi-panel-name = "hx8379a ty truly fwvga video mode dsi panel";
                qcom,cont-splash-enabled;
		qcom,mdss-dsi-panel-controller = <&mdss_dsi0>;
		qcom,mdss-dsi-panel-type = "dsi_video_mode";
		qcom,mdss-dsi-panel-destination = "display_1";
		qcom,mdss-dsi-panel-framerate = <60>;
		qcom,mdss-dsi-virtual-channel-id = <0>;
		qcom,mdss-dsi-stream = <0>;
		qcom,mdss-dsi-panel-width = <480>;
		qcom,mdss-dsi-panel-height = <854>;
		qcom,mdss-dsi-h-front-porch = <70>;
		qcom,mdss-dsi-h-back-porch = <90>;
		qcom,mdss-dsi-h-pulse-width = <90>;
		qcom,mdss-dsi-h-sync-skew = <0>;
		qcom,mdss-dsi-v-back-porch = <7>;
		qcom,mdss-dsi-v-front-porch = <6>;
		qcom,mdss-dsi-v-pulse-width = <4>;
		qcom,mdss-dsi-h-left-border = <0>;
		qcom,mdss-dsi-h-right-border = <0>;
		qcom,mdss-dsi-v-top-border = <0>;
		qcom,mdss-dsi-v-bottom-border = <0>;
		qcom,mdss-dsi-bpp = <24>;
		qcom,mdss-dsi-color-order = "rgb_swap_rgb";
		qcom,mdss-dsi-underflow-color = <0xff>;
		qcom,mdss-dsi-border-color = <0>;
		qcom,mdss-dsi-pixel-packing = "tight";
		qcom,mdss-dsi-on-command = [
					39 01 00 00 00 00 04
				                B9 FF 83 79 
					39 01 00 00 00 00 02
					        BA 51   
					39 01 00 00 00 00 14
				                B1 00 50 24
				                EA 8D 08 11
				                11 11 27 2F
				                3f 3f 42 0B
					        6E F1 00 E6
					39 01 00 00 00 00 0E
					        B2 00 00 FE
					        08 04 19 22
					        00 FF 08 04
					        19 20
					39 01 00 00 00 00 20
					        B4 82 08 00
					        32 10 03 32
					        13 70 32 10
					        08 37 01 28
					        07 37 0a 35
					        08 3D 44 08
					        00 40 08 28
					        08 30 30 04
					39 01 00 00 00 00 30
					        D5 00 00 0a
					        00 01 05 00
					        03 00 88 88
					        88 88 23 01
					        67 45 02 13
					        88 88 88 88
					        88 88 88 88
					        88 88 54 76
					        10 32 31 20
					        88 88 88 88
					        88 88 00 00
					        00 00 00 00
					39 01 00 00 00 00 24
					        E0 79 03 02
					        09 13 12 3f
					        25 35 07 0E
					        10 15 17 16
					        16 11 13 03
					        02 09 13 12
					        3f 25 35 07
					        0E 10 15 17
					        16 16 11 13
					39 01 00 00 00 00 02
					        CC 02
					39 01 00 00 00 00 05
					        B6 00 9a 00
					        9a
					05 01 00 00 78 00 02 11 00
                                        05 01 00 00 64 00 02 29 00
					];
		qcom,mdss-dsi-off-command = [05 01 00 00 32 00 02 28 00
					05 01 00 00 78 00 02 10 00];
		qcom,mdss-dsi-on-command-state = "dsi_lp_mode";
		qcom,mdss-dsi-off-command-state = "dsi_lp_mode";
		qcom,mdss-dsi-h-sync-pulse = <1>;
		qcom,mdss-dsi-traffic-mode = "non_burst_sync_pulse";
		qcom,mdss-dsi-lane-map = "lane_map_0123";
		qcom,mdss-dsi-bllp-eof-power-mode;
		qcom,mdss-dsi-bllp-power-mode;
		qcom,mdss-dsi-lane-0-state;
		qcom,mdss-dsi-lane-1-state;
		//qcom,mdss-dsi-panel-timings = [8B 1F 14 00 45 4A 19 23 23 03 04 00];
		//qcom,mdss-dsi-t-clk-post = <0x04>;
		//qcom,mdss-dsi-t-clk-pre = <0x1b>;
		qcom,mdss-dsi-panel-timings = [57 26 1B 00 35 34 20 28 2F 03 04 00];
		qcom,mdss-dsi-t-clk-post = <0x20>;
		qcom,mdss-dsi-t-clk-pre = <0x3a>;
		qcom,mdss-dsi-bl-min-level = <1>;
		qcom,mdss-dsi-bl-max-level = <4095>;
		qcom,mdss-dsi-dma-trigger = "trigger_sw";
		qcom,mdss-dsi-mdp-trigger = "none";
		qcom,mdss-dsi-bl-pmic-control-type = "bl_ctrl_wled";
		qcom,mdss-dsi-reset-sequence = <1 20>, <0 10>, <1 20>;
		qcom,mdss-dsi-lp11-init;
		qcom,mdss-dsi-init-delay-us = <50000>;

	};
};
