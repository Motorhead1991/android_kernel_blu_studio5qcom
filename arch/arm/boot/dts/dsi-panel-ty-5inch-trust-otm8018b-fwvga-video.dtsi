/* Copyright (c) 2013, The Linux Foundation. All rights reserved.
 *
 * This program is free software; you can redistribute it and/or modify
 * it under the terms of the GNU General Public License version 2 and
 * only version 2 as published by the Free Software Foundation.
 *
 * This program is distributed in the hope that it will be useful,
 * but WITHOUT ANY WARRANTY; without even the implied warranty of
 * MERCHANTABILITY or FITNESS FOR A PARTICULAR PURPOSE.  See the
 * GNU General Public License for more details.
 */

/*---------------------------------------------------------------------------
 * This file is autogenerated file using gcdb parser. Please do not edit it.
 * Update input XML file to add a new entry or update variable in this file
 * VERSION = "1.0"
 *---------------------------------------------------------------------------*/
&mdss_mdp {
	dsi_ty_trust_otm8018b_fwvga_vid: qcom,mdss_dsi_5inch_trust_otm8018b_fwvga_video {
		qcom,mdss-dsi-panel-name = "OTM8018b ty 5inch trust fwvga video mode dsi panel";
 		qcom,cont-splash-enabled;
		qcom,mdss-dsi-panel-controller = <&mdss_dsi0>;
		qcom,mdss-dsi-panel-type = "dsi_video_mode";
		qcom,mdss-dsi-panel-destination = "display_1";
		qcom,mdss-dsi-panel-framerate = <60>;
		qcom,mdss-dsi-virtual-channel-id = <0>;
		qcom,mdss-dsi-stream = <0>;
		qcom,mdss-dsi-panel-width = <480>;
		qcom,mdss-dsi-panel-height = <854>;
		qcom,mdss-dsi-h-front-porch = <80>;
		qcom,mdss-dsi-h-back-porch = <54>;
		qcom,mdss-dsi-h-pulse-width = <8>;
		qcom,mdss-dsi-h-sync-skew = <0>;
		qcom,mdss-dsi-v-back-porch = <16>;
		qcom,mdss-dsi-v-front-porch = <12>;
		qcom,mdss-dsi-v-pulse-width = <2>;
		qcom,mdss-dsi-h-left-border = <0>;
		qcom,mdss-dsi-h-right-border = <0>;
		qcom,mdss-dsi-v-top-border = <0>;
		qcom,mdss-dsi-v-bottom-border = <0>;
		qcom,mdss-dsi-bpp = <24>;
		qcom,mdss-dsi-underflow-color = <0xff>;
		qcom,mdss-dsi-border-color = <0>;
		qcom,mdss-dsi-on-command = [
 		29 01 00 00 00 00 02 00 00 
 		29 01 00 00 00 00 04 ff 80 09 01 
 		29 01 00 00 00 00 02 00 80 
 		29 01 00 00 00 00 03 ff 80 09 
 		29 01 00 00 00 00 02 00 03 
 		29 01 00 00 00 00 02 ff 01 
 		29 01 00 00 00 00 02 00 b4 
 		29 01 00 00 00 00 02 c0 50    
 		29 01 00 00 00 00 02 00 82 
 		29 01 00 00 00 00 02 c5 a3 
 		29 01 00 00 00 00 02 00 90 
 		29 01 00 00 00 00 03 c5 96 76    
 		29 01 00 00 00 00 02 00 00 
 		29 01 00 00 00 00 03 d8 97 97   
 		29 01 00 00 00 00 02 00 00 
 		29 01 00 00 00 00 02 d9 3d    
 		29 01 00 00 00 00 02 00 00 
 		29 01 00 00 00 00 11 e1 09 0c 12 0e 08 1c 0e 0E 00 04 02 07 0F 21 1C 0f 
 		29 01 00 00 00 00 02 00 00 
 		29 01 00 00 00 00 11 e2 09 0c 12 0e 08 1c 0e 0E 00 04 02 07 0E 20 1D 0f 
 		29 01 00 00 00 00 02 00 81 
 		29 01 00 00 00 00 02 c1 77 
 		29 01 00 00 00 00 02 00 a1 
 		29 01 00 00 00 00 02 c1 0e 
 		29 01 00 00 00 00 02 00 a0 
 		29 01 00 00 00 00 02 c1 ea 
 		29 01 00 00 00 00 02 00 89 
 		29 01 00 00 00 00 02 c4 08 
 		29 01 00 00 00 00 02 00 a2 
 		29 01 00 00 00 00 04 c0 04 00 02 
 		29 01 00 00 00 00 02 00 80 
 		29 01 00 00 00 00 02 c4 30 
 		29 01 00 00 00 00 02 00 a6 
 		29 01 00 00 00 00 02 c1 01 
 		29 01 00 00 00 00 02 00 c0 
 		29 01 00 00 00 00 02 c5 00 
 		29 01 00 00 00 00 02 00 8b 
 		29 01 00 00 00 00 02 b0 40 
 		29 01 00 00 00 00 02 00 b2 
 		29 01 00 00 00 00 05 f5 15 00 15 00 
 		29 01 00 00 00 00 02 00 93 
 		29 01 00 00 00 00 02 c5 03 
 		29 01 00 00 00 00 02 00 81 
 		29 01 00 00 00 00 02 c4 83 
 		29 01 00 00 00 00 02 00 92 
 		29 01 00 00 00 00 02 c5 01 
 		29 01 00 00 00 00 02 00 b1 
 		29 01 00 00 00 00 02 c5 a9 
 		29 01 00 00 00 00 02 00 92 
 		29 01 00 00 00 00 02 b3 45 
 		29 01 00 00 00 00 02 00 90 
 		29 01 00 00 00 00 02 b3 02 
 		29 01 00 00 00 00 02 00 80 
 		29 01 00 00 00 00 06 c0 00 58 00 14 16 
 		29 01 00 00 00 00 02 00 90 
 		29 01 00 00 00 00 07 c0 00 56 00 00 00 03 
 		29 01 00 00 00 00 02 00 a6 
 		29 01 00 00 00 00 04 c1 01 00 00 
 		29 01 00 00 00 00 02 00 80 
 		29 01 00 00 00 00 0d ce 87 03 00 85 03 00 86 03 00 84 03 00 
 		29 01 00 00 00 00 02 00 a0 
 		29 01 00 00 00 00 0f ce 38 03 03 58 00 00 00 38 02 03 59 00 00 00 
 		29 01 00 00 00 00 02 00 b0 
 		29 01 00 00 00 00 0f ce 38 01 03 5a 00 00 00 38 00 03 5b 00 00 00 
 		29 01 00 00 00 00 02 00 c0 
		29 01 00 00 00 00 0f ce 30 00 03 5c 00 00 00 30 01 03 5d 00 00 00 
 		29 01 00 00 00 00 02 00 d0 
 		29 01 00 00 00 00 0f ce 30 02 03 5e 00 00 00 30 03 03 5f 00 00 00 
 		29 01 00 00 00 00 02 00 c7 
 		29 01 00 00 00 00 02 cf 00 
 		29 01 00 00 00 00 02 00 c9 
 		29 01 00 00 00 00 02 cf 00 
 		29 01 00 00 00 00 02 00 c4 
 		29 01 00 00 00 00 07 cb 04 04 04 04 04 04 
 		29 01 00 00 00 00 02 00 d9 
 		29 01 00 00 00 00 07 cb 04 04 04 04 04 04 
 		29 01 00 00 00 00 02 00 84 
 		29 01 00 00 00 00 07 cc 0c 0a 10 0e 03 04 
 		29 01 00 00 00 00 02 00 9e 
 		29 01 00 00 00 00 02 cc 0b 
 		29 01 00 00 00 00 02 00 a0 
 		29 01 00 00 00 00 06 cc 09 0f 0d 01 02 
 		29 01 00 00 00 00 02 00 b4 
 		29 01 00 00 00 00 07 cc 0d 0f 09 0b 02 01 
 		29 01 00 00 00 00 02 00 ce 
 		29 01 00 00 00 00 02 cc 0e 
 		29 01 00 00 00 00 02 00 d0 
 		29 01 00 00 00 00 08 cc 10 0a 0c 04 03 05 85 
 		29 01 00 00 00 00 02 00 00 
 		29 01 00 00 00 00 04 ff ff ff ff 
 		29 01 00 00 00 00 02 11 00 
 		29 01 00 00 00 00 02 29 00 
 		29 01 00 00 00 00 02 2C 00 
 		05 01 00 00 78 00 02 11 00
 		05 01 00 00 20 00 02 29 00];

		qcom,mdss-dsi-off-command = [
					05 01 00 00 20 00 02 28 00
					05 01 00 00 78 00 02 10 00];
		qcom,mdss-dsi-on-command-state = "dsi_lp_mode";
		qcom,mdss-dsi-off-command-state = "dsi_lp_mode";
		qcom,mdss-dsi-h-sync-pulse = <0>;
		qcom,mdss-dsi-traffic-mode = "non_burst_sync_event";
		qcom,mdss-dsi-lane-map = "lane_map_3012";
		qcom,mdss-dsi-bllp-eof-power-mode;
		qcom,mdss-dsi-bllp-power-mode;
		qcom,mdss-dsi-lane-0-state;
		qcom,mdss-dsi-lane-1-state;
		qcom,mdss-dsi-panel-timings = [8B 1F 14 00 45 4A 19 23 23 03 04 00];
		qcom,mdss-dsi-t-clk-post = <0x04>;
		qcom,mdss-dsi-t-clk-pre = <0x1b>;
		qcom,mdss-dsi-bl-min-level = <1>;
		qcom,mdss-dsi-bl-max-level = <4095>;
		qcom,mdss-dsi-dma-trigger = "trigger_sw";
		qcom,mdss-dsi-mdp-trigger = "none";
		qcom,mdss-dsi-bl-pmic-control-type = "bl_ctrl_wled";
		qcom,mdss-dsi-reset-sequence = <1 20>, <0 2>, <1 20>;
		qcom,mdss-dsi-lp11-init;
		qcom,mdss-dsi-init-delay-us = <50000>;
	};
};
