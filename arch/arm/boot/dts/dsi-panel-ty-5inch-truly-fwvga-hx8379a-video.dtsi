/* Copyright (c) 2013, The Linux Foundation. All rights reserved.
 *
 * This program is free software; you can redistribute it and/or modify
 * it under the terms of the GNU General Public License version 2 and
 * only version 2 as published by the Free Software Foundation.
 *
 * This program is distributed in the hope that it will be useful,
 * but WITHOUT ANY WARRANTY; without even the implied warranty of
 * MERCHANTABILITY or FITNESS FOR A PARTICULAR PURPOSE.  See the
 * GNU General Public License for more details.
 */

/*---------------------------------------------------------------------------
 * This file is autogenerated file using gcdb parser. Please do not edit it.
 * Update input XML file to add a new entry or update variable in this file
 * VERSION = "1.0"
 *---------------------------------------------------------------------------*/
&mdss_mdp {
	dsi_ty_5inch_truly_hx8379a_fwvga_vid: qcom,mdss_dsi_ty_5inch_truly_hx8379a_fwvga_video {
		qcom,mdss-dsi-panel-name = " ty truly 5inch fwvga hx8379a video mode dsi panel";
		qcom,cont-splash-enabled;
		qcom,mdss-dsi-panel-controller = <&mdss_dsi0>;
		qcom,mdss-dsi-panel-type = "dsi_video_mode";
		qcom,mdss-dsi-panel-destination = "display_1";
		qcom,mdss-dsi-panel-framerate = <60>;
		qcom,mdss-dsi-virtual-channel-id = <0>;
		qcom,mdss-dsi-stream = <0>;
		qcom,mdss-dsi-panel-width = <480>;
		qcom,mdss-dsi-panel-height = <854>;
		qcom,mdss-dsi-h-front-porch = <31>;
		qcom,mdss-dsi-h-back-porch = <31>;
		qcom,mdss-dsi-h-pulse-width = <31>;
		qcom,mdss-dsi-h-sync-skew = <0>;
		qcom,mdss-dsi-v-back-porch = <8>;
		qcom,mdss-dsi-v-front-porch = <11>;
		qcom,mdss-dsi-v-pulse-width = <5>;
		qcom,mdss-dsi-h-left-border = <0>;
		qcom,mdss-dsi-h-right-border = <0>;
		qcom,mdss-dsi-v-top-border = <0>;
		qcom,mdss-dsi-v-bottom-border = <0>;
		qcom,mdss-dsi-bpp = <24>;
		qcom,mdss-dsi-underflow-color = <0xff>;
		qcom,mdss-dsi-border-color = <0>;
		qcom,mdss-dsi-on-command = [
		39 01 00 00 00 00 04 B9 FF 83 79
		39 01 00 00 00 00 02 BA 51
		39 01 00 00 00 00 14 B1 00 50 44 E9 8D 08 11 11 11 20 27 9A 1A 42 0B 6E F1 00 E6
		39 01 00 00 00 00 0E B2 00 00 FE 08 04 19 22 00 FF 08 04 19 20
		39 01 00 00 00 00 20 B4 80 08 00 32 10 04 32 13 70 32 10 08 37 01 28 06 37 00 36 06 30 38 06 00 40 08 28 08 30 30 04
		39 01 00 00 00 00 02 CC 02
		39 01 00 00 00 00 30 D5 00 00 0A 00 01 00 00 03 00 99 88 AA BB 23 01 67 45 01 23 88 88 88 88 88 88 88 99 BB AA 54 76 10 32 32 10 88 88 88 88 88 88 3C 01 00 00 00 00
		39 01 00 00 00 00 24 E0 79 00 02 01 19 18 20 2B 3E 07 0D 0F 14 18 16 16 12 17 00 02 01 19 18 20 2B 3E 07 0D 0F 14 18 16 16 12 17 
		39 01 00 00 00 00 02 B3 07
		39 01 00 00 00 00 05 B6 00 83 00 83
		05 01 00 00 96 00 02 11 00
		05 01 00 00 78 00 02 29 00];
		qcom,mdss-dsi-off-command = [05 01 00 00 32 00 02 28 00
					     05 01 00 00 78 00 02 10 00];
		qcom,mdss-dsi-on-command-state = "dsi_lp_mode";
		qcom,mdss-dsi-off-command-state = "dsi_lp_mode";
		qcom,mdss-dsi-h-sync-pulse = <0>;
		qcom,mdss-dsi-traffic-mode = "non_burst_sync_event";
		qcom,mdss-dsi-lane-map = "lane_map_3012";
		qcom,mdss-dsi-bllp-eof-power-mode;
		qcom,mdss-dsi-bllp-power-mode;
		qcom,mdss-dsi-lane-0-state;
		qcom,mdss-dsi-lane-1-state;
		qcom,mdss-dsi-panel-timings = [5e 1d 15 00 2e 2b 1a 1f 25 03 04 00];
		qcom,mdss-dsi-t-clk-post = <0x20>;
		qcom,mdss-dsi-t-clk-pre = <0x2a>;
		qcom,mdss-dsi-bl-min-level = <1>;
		qcom,mdss-dsi-bl-max-level = <4095>;
		qcom,mdss-dsi-dma-trigger = "trigger_sw";
		qcom,mdss-dsi-mdp-trigger = "none";
		qcom,mdss-dsi-bl-pmic-control-type = "bl_ctrl_wled";
		qcom,mdss-dsi-reset-sequence = <1 20>, <0 2>, <1 20>;
		qcom,mdss-dsi-lp11-init;
		qcom,mdss-dsi-init-delay-us = <50000>;
	};
};
