/* Copyright (c) 2013, The Linux Foundation. All rights reserved.
 *
 * This program is free software; you can redistribute it and/or modify
 * it under the terms of the GNU General Public License version 2 and
 * only version 2 as published by the Free Software Foundation.
 *
 * This program is distributed in the hope that it will be useful,
 * but WITHOUT ANY WARRANTY; without even the implied warranty of
 * MERCHANTABILITY or FITNESS FOR A PARTICULAR PURPOSE.  See the
 * GNU General Public License for more details.
 */

/*---------------------------------------------------------------------------
 * This file is autogenerated file using gcdb parser. Please do not edit it.
 * Update input XML file to add a new entry or update variable in this file
 * VERSION = "1.0"
 *---------------------------------------------------------------------------*/
&mdss_mdp {
	dsi_ty_tianma_otm8018b_fwvga_vid: qcom,mdss_dsi_ty_tianma_otm8018b_fwvga_video {
		qcom,mdss-dsi-panel-name = "OTM8018b ty tianma fwvga video mode dsi panel";
		qcom,mdss-dsi-panel-controller = <&mdss_dsi0>;
		qcom,mdss-dsi-panel-type = "dsi_video_mode";
		qcom,mdss-dsi-panel-destination = "display_1";
		qcom,mdss-dsi-panel-framerate = <60>;
		qcom,mdss-dsi-virtual-channel-id = <0>;
		qcom,mdss-dsi-stream = <0>;
		qcom,mdss-dsi-panel-width = <480>;
		qcom,mdss-dsi-panel-height = <854>;
		qcom,mdss-dsi-h-front-porch = <100>;//80
		qcom,mdss-dsi-h-back-porch = <100>;//54
		qcom,mdss-dsi-h-pulse-width = <12>;//8
		qcom,mdss-dsi-h-sync-skew = <0>;
		qcom,mdss-dsi-v-back-porch = <20>;//16
		qcom,mdss-dsi-v-front-porch = <30>;//12
		qcom,mdss-dsi-v-pulse-width = <14>;//2
		qcom,mdss-dsi-h-left-border = <0>;
		qcom,mdss-dsi-h-right-border = <0>;
		qcom,mdss-dsi-v-top-border = <0>;
		qcom,mdss-dsi-v-bottom-border = <0>;
		qcom,mdss-dsi-bpp = <24>;
		qcom,mdss-dsi-color-order = "rgb_swap_rgb";
		qcom,mdss-dsi-underflow-color = <0xff>;
		qcom,mdss-dsi-border-color = <0>;
		qcom,mdss-dsi-pixel-packing = "tight";
		qcom,mdss-dsi-on-command = [
					29 01 00 00 00 00 02
						00 00 
					29 01 00 00 00 00 04
						FF 80 09 01   
					29 01 00 00 00 00 02
						00 80 
					29 01 00 00 00 00 03
						FF 80 09      
					29 01 00 00 00 00 02
						00 03 
					29 01 00 00 00 00 02
						FF 01         
					29 01 00 00 00 00 02
						00 B4 
					29 01 00 00 00 00 02
						C0 10         
					29 01 00 00 00 00 02
						00 89 
					29 01 00 00 00 00 02
						C4 08         
					29 01 00 00 00 00 02
						00 82 
					29 01 00 00 00 00 02
						C5 A3         
					29 01 00 00 00 00 02
						00 90 
					29 01 00 00 00 00 03
						C5 96 76   
					29 01 00 00 00 00 02
						00 00 
					29 01 00 00 00 00 03
						D8 6F 6F      
					29 01 00 00 00 00 02
						00 00 
					29 01 00 00 00 00 02
						D9 78         
					29 01 00 00 00 00 02
						00 00 
					29 01 00 00 00 00 02
						00 00         
					29 01 00 00 00 00 02
						00 81 
					29 01 00 00 00 00 02
						C1 66			
					29 01 00 00 00 00 02
						00 81 
					29 01 00 00 00 00 02
						C4 83         
					29 01 00 00 00 00 02
						00 92 
					29 01 00 00 00 00 02
						C5 01         
					29 01 00 00 00 00 02
						00 B1 
					29 01 00 00 00 00 02
						C5 59         
					29 01 00 00 00 00 02
						00 90 
					29 01 00 00 00 00 02
						B3 02         
					29 01 00 00 00 00 02
						00 92 
					29 01 00 00 00 00 02
						B3 45         
					29 01 00 00 00 00 02
						00 80 
					29 01 00 00 00 00 0A
						C0 00 58 00
						15 15 00 58
						15 15 
					29 01 00 00 00 00 02
						00 90 
					29 01 00 00 00 00 07
						C0 00 44 00
						00 00 03          
					29 01 00 00 00 00 02
						00 A6 
					29 01 00 00 00 00 04
						C1 00 00 00  
					29 01 00 00 00 00 02
						00 80 
					29 01 00 00 00 00 07
						CE 85 03 00 
						84 03 00
					29 01 00 00 00 00 02
						00 90 
					29 01 00 00 00 00 07
						CE 33 5c 00 
						33 5d 00						 
					29 01 00 00 00 00 02
						00 A0 
					29 01 00 00 00 00 0F
						CE 38 03 03 
						56 00 00 00 
						38 02 03 57 
						00 00 00 
					29 01 00 00 00 00 02
						00 B0 
					29 01 00 00 00 00 0F
						CE 38 01 03 
						58 00 00 00 
						38 00 03 59 
						00 00 00 					
					29 01 00 00 00 00 02
						00 C0 
					29 01 00 00 00 00 0F
						CE 30 00 03 
						5a 00 00 00 
						30 01 03 5b 
						00 00 00 					
					29 01 00 00 00 00 02
						00 D0 
					29 01 00 00 00 00 0F
						CE 30 02 03 
						5c 00 00 00 
						30 03 03 5d 
						00 00 00 
					29 01 00 00 00 00 02
						00 C7
					29 01 00 00 00 00 02
						CF 00
					29 01 00 00 00 00 02
						00 C0 
					29 01 00 00 00 00 10
						CB 00 00 00 
						00 54 54 54 
						54 00 54 00 
						54 00 00 00 					
					29 01 00 00 00 00 02
						00 D0 
					29 01 00 00 00 00 10
						CB 00 00 00 
						00 00 04 00 
						00 00 54 54 
						54 54 00 54 					
					29 01 00 00 00 00 02
						00 E0 
					29 01 00 00 00 00 0a
						CB 00 54 00 
						00 00 00 00 
						00 00						      
					29 01 00 00 00 00 02
						00 80 
					29 01 00 00 00 00 0B
						CC 00 00 00 
						00 0C 0A 10 
						0E 00 02				
					29 01 00 00 00 00 02
						00 90 
					29 01 00 00 00 00 10
						CC 00 06 00 
						00 00 00 00 
						00 00 00 00 
						00 00 00 0B 
					29 01 00 00 00 00 02
						00 A0 
					29 01 00 00 00 00 10
						CC 09 0F 0D 
						00 01 00 05 
						00 00 00 00 
						00 00 00 00
					29 01 00 00 00 00 02
						00 B0 
					29 01 00 00 00 00 0B
						CC 00 00 00 
						00 0d 0f 09 
						0b 00 05				
					29 01 00 00 00 00 02
						00 C0 
					29 01 00 00 00 00 10
						CC 00 01 00 
						00 00 00 00 
						00 00 00 00 
						00 00 00 0e					 
					29 01 00 00 00 00 02
						00 D0 
					29 01 00 00 00 00 10
						CC 10 0a 0c 
						00 06 00 02 
						00 00 00 00 
						00 00 00 00 					
					29 01 00 00 00 00 02
						00 00
					29 01 00 00 00 00 11
						E1 01 09 0E 
						0D 07 0C 2A 
						29 03 06 12 
						07 0E 12 0B 
						06					
					29 01 00 00 00 00 02
						00 00 
					29 01 00 00 00 00 11
						E2 01 09 0E 
						0D 07 0C 2A 
						29 03 06 12 
						08 0F 12 0B 
						06
					05 01 00 00 00 00 02
						51 FF
					05 01 00 00 00 00 02
						53 24
					05 01 00 00 0A 00 02
						55 01
					05 01 00 00 82 00 02
						11 00
					05 01 00 00 20 00 02
						29 00
					05 01 00 00 00 00 02
						2C 00
					];
		qcom,mdss-dsi-off-command = [05 01 00 00 32 00 02 28 00
					05 01 00 00 78 00 02 10 00];
		qcom,mdss-dsi-on-command-state = "dsi_lp_mode";
		qcom,mdss-dsi-off-command-state = "dsi_lp_mode";
		qcom,mdss-dsi-h-sync-pulse = <0>;
		qcom,mdss-dsi-traffic-mode = "non_burst_sync_event";
		qcom,mdss-dsi-lane-map = "lane_map_0123";
		qcom,mdss-dsi-bllp-eof-power-mode;
		qcom,mdss-dsi-bllp-power-mode;
		qcom,mdss-dsi-lane-0-state;
		qcom,mdss-dsi-lane-1-state;
		qcom,mdss-dsi-panel-timings = [59 23 1B 00 36 31 20 25 25 03 04 00];
		qcom,mdss-dsi-t-clk-post = <0x04>;
		qcom,mdss-dsi-t-clk-pre = <0x1b>;
		qcom,mdss-dsi-bl-min-level = <1>;
		qcom,mdss-dsi-bl-max-level = <4095>;
		qcom,mdss-dsi-dma-trigger = "trigger_sw";
		qcom,mdss-dsi-mdp-trigger = "none";
		qcom,mdss-dsi-bl-pmic-control-type = "bl_ctrl_wled";
		qcom,mdss-dsi-reset-sequence = <1 20>, <0 2>, <1 20>;
		qcom,mdss-dsi-lp11-init = <1>;
		qcom,mdss-dsi-init-delay-us = <50000>;

	};
};
