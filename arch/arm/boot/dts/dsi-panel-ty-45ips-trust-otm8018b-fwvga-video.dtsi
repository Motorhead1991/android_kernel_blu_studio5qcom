/* Copyright (c) 2013, The Linux Foundation. All rights reserved.
 *
 * This program is free software; you can redistribute it and/or modify
 * it under the terms of the GNU General Public License version 2 and
 * only version 2 as published by the Free Software Foundation.
 *
 * This program is distributed in the hope that it will be useful,
 * but WITHOUT ANY WARRANTY; without even the implied warranty of
 * MERCHANTABILITY or FITNESS FOR A PARTICULAR PURPOSE.  See the
 * GNU General Public License for more details.
 */

/*---------------------------------------------------------------------------
 * This file is autogenerated file using gcdb parser. Please do not edit it.
 * Update input XML file to add a new entry or update variable in this file
 * VERSION = "1.0"
 *---------------------------------------------------------------------------*/
&mdss_mdp {
	dsi_ty_45ips_trust_otm8018b_fwvga_vid: qcom,mdss_dsi_ty_45ips_trust_otm8018b_fwvga_video {
		qcom,mdss-dsi-panel-name = "OTM8018b 45ips trust fwvga video mode dsi panel";
		qcom,cont-splash-enabled;
		qcom,mdss-dsi-panel-controller = <&mdss_dsi0>;
		qcom,mdss-dsi-panel-type = "dsi_video_mode";
		qcom,mdss-dsi-panel-destination = "display_1";
		qcom,mdss-dsi-panel-framerate = <60>;
		qcom,mdss-dsi-virtual-channel-id = <0>;
		qcom,mdss-dsi-stream = <0>;
		qcom,mdss-dsi-panel-width = <480>;
		qcom,mdss-dsi-panel-height = <854>;
		qcom,mdss-dsi-h-front-porch = <80>;
		qcom,mdss-dsi-h-back-porch = <54>;
		qcom,mdss-dsi-h-pulse-width = <8>;
		qcom,mdss-dsi-h-sync-skew = <0>;
		qcom,mdss-dsi-v-back-porch = <16>;
		qcom,mdss-dsi-v-front-porch = <12>;
		qcom,mdss-dsi-v-pulse-width = <2>;
		qcom,mdss-dsi-h-left-border = <0>;
		qcom,mdss-dsi-h-right-border = <0>;
		qcom,mdss-dsi-v-top-border = <0>;
		qcom,mdss-dsi-v-bottom-border = <0>;
		qcom,mdss-dsi-bpp = <24>;
		qcom,mdss-dsi-color-order = "rgb_swap_rgb";
		qcom,mdss-dsi-underflow-color = <0xff>;
		qcom,mdss-dsi-border-color = <0>;
		qcom,mdss-dsi-pixel-packing = "tight";
		qcom,mdss-dsi-on-command = [
					29 01 00 00 00 00 02 00 00
					29 01 00 00 00 00 04 FF 80 09 01
					29 01 00 00 00 00 02 00 80
					29 01 00 00 00 00 03 FF 80 09
					29 01 00 00 00 00 02 00 03
					29 01 00 00 00 00 02 FF 01
					29 01 00 00 00 00 02 00 B4
					29 01 00 00 00 00 02 C0 50
					29 01 00 00 00 00 02 00 81
					29 01 00 00 00 00 02 C5 66
					29 01 00 00 00 00 02 00 82
					29 01 00 00 00 00 02 C5 A3
					29 01 00 00 00 00 02 00 90
					29 01 00 00 00 00 03 C5 96 87
					29 01 00 00 00 00 02 00 00
					29 01 00 00 00 00 03 D8 62 62
					29 01 00 00 00 00 02 00 00
					29 01 00 00 00 00 02 D9 66
					29 01 00 00 00 00 02 00 00
					29 01 00 00 00 00 11 E1 01 06 0b 0d 06 0c 0a 09 05 08 0f 08 0f 16 11 0F
					29 01 00 00 00 00 02 00 00
					29 01 00 00 00 00 11 E2 01 06 0a 0d 05 0c 0b 08 05 07 0e 07 0E 16 11 0F
					29 01 00 00 00 00 02 00 81
					29 01 00 00 00 00 02 C1 66
					29 01 00 00 00 00 02 00 A1
					29 01 00 00 00 00 02 C1 08
					29 01 00 00 00 00 02 00 89
					29 01 00 00 00 00 02 C4 00
					29 01 00 00 00 00 02 00 A2
					29 01 00 00 00 00 04 C0 02 1B 02
					29 01 00 00 00 00 02 00 81
					29 01 00 00 00 00 02 C4 83
					29 01 00 00 00 00 02 00 92
					29 01 00 00 00 00 02 C5 01
					29 01 00 00 00 00 02 00 B1
					29 01 00 00 00 00 02 C5 A9
					29 01 00 00 00 00 02 00 A0
					29 01 00 00 00 00 02 C1 EA
					29 01 00 00 00 00 02 00 A6
					29 01 00 00 00 00 02 C1 01
					29 01 00 00 00 00 02 00 C0
					29 01 00 00 00 00 02 C5 00
					29 01 00 00 00 00 02 00 8B
					29 01 00 00 00 00 02 B0 40
					29 01 00 00 00 00 02 00 B2
					29 01 00 00 00 00 05 F5 15 00 15 00
					29 01 00 00 00 00 02 00 B6
					29 01 00 00 00 00 02 F5 06
					29 01 00 00 00 00 02 00 93
					29 01 00 00 00 00 02 C5 03
					29 01 00 00 00 00 02 00 92
					29 01 00 00 00 00 02 B3 45
					29 01 00 00 00 00 02 00 90
					29 01 00 00 00 00 02 B3 02
					29 01 00 00 00 00 02 00 80
					29 01 00 00 00 00 02 C4 30
					29 01 00 00 00 00 02 00 8A
					29 01 00 00 00 00 02 C4 40
					29 01 00 00 00 00 02 00 90
					29 01 00 00 00 00 02 B3 02
					29 01 00 00 00 00 02 00 92
					29 01 00 00 00 00 02 B3 45
					29 01 00 00 00 00 02 00 80
					29 01 00 00 00 00 0a C0 00 58 00 15 15 00 58 15 15
					29 01 00 00 00 00 02 00 90
					29 01 00 00 00 00 07 C0 00 56 00 00 00 03
					29 01 00 00 00 00 02 00 A6
					29 01 00 00 00 00 04 C1 01 00 00
					29 01 00 00 00 00 02 00 80
					29 01 00 00 00 00 0d CE 8B 03 00 8A 03 00 89 03 00 88 03 00
					29 01 00 00 00 00 02 00 A0
					29 01 00 00 00 00 0f CE 38 07 03 54 00 00 00 38 06 03 55 00 00 00
					29 01 00 00 00 00 02 00 B0
					29 01 00 00 00 00 0f CE 38 05 03 56 00 00 00 38 04 03 57 00 00 00
					29 01 00 00 00 00 02 00 C0
					29 01 00 00 00 00 0f CE 38 03 03 58 00 00 00 38 02 03 59 00 00 00
					29 01 00 00 00 00 02 00 D0
					29 01 00 00 00 00 0f CE 38 01 03 5A 00 00 00 38 00 03 5B 00 00 00
					29 01 00 00 00 00 02 00 C0
					29 01 00 00 00 00 0b CF 02 02 00 00 00 00 01 00 00 00
					29 01 00 00 00 00 02 00 80
					29 01 00 00 00 00 0b CB 00 00 00 00 00 00 00 00 00 00
					29 01 00 00 00 00 02 00 90
					29 01 00 00 00 00 10 CB 00 00 00 00 00 00 00 00 00 00 00 00 00 00 00
					29 01 00 00 00 00 02 00 A0
					29 01 00 00 00 00 10 CB 00 00 00 00 00 00 00 00 00 00 00 00 00 00 00
					29 01 00 00 00 00 02 00 B0
					29 01 00 00 00 00 0b CB 00 00 00 00 00 00 00 00 00 00
					29 01 00 00 00 00 02 00 C0
					29 01 00 00 00 00 10 CB 04 04 04 04 04 04 04 04 04 04 00 00 00 00 00
					29 01 00 00 00 00 02 00 D0
					29 01 00 00 00 00 10 CB 00 00 00 00 00 04 04 04 04 04 04 04 04 04 04
					29 01 00 00 00 00 02 00 E0
					29 01 00 00 00 00 0b CB 00 00 00 00 00 00 00 00 00 00
					29 01 00 00 00 00 02 00 F0
					29 01 00 00 00 00 0b CB FF FF FF FF FF FF FF FF FF FF
					29 01 00 00 00 00 02 00 80
					29 01 00 00 00 00 0b CC 26 25 21 22 0C 0A 10 0E 02 04
					29 01 00 00 00 00 02 00 90
					29 01 00 00 00 00 10 CC 00 00 00 00 00 00 00 00 00 00 26 25 21 22 0B
					29 01 00 00 00 00 02 00 A0
					29 01 00 00 00 00 10 CC 09 0F 0D 01 03 00 00 00 00 00 00 00 00 00 00
					29 01 00 00 00 00 02 00 B0
					29 01 00 00 00 00 0b CC 25 26 21 22 10 0A 0C 0E 04 02
					29 01 00 00 00 00 02 00 C0
					29 01 00 00 00 00 10 CC 00 00 00 00 00 00 00 00 00 00 25 26 21 22 0F
					29 01 00 00 00 00 02 00 D0
					29 01 00 00 00 00 10 CC 09 0B 0D 03 01 00 00 00 00 00 00 00 00 00 00
					29 01 00 00 00 00 02 00 00
					29 01 00 00 00 00 04 FF FF FF FF
					05 01 00 00 64 00 02 11 00
					05 01 00 00 00 00 02 29 00
					];
		qcom,mdss-dsi-off-command = [05 01 00 00 32 00 02 28 00
					05 01 00 00 78 00 02 10 00];
		qcom,mdss-dsi-on-command-state = "dsi_lp_mode";
		qcom,mdss-dsi-off-command-state = "dsi_lp_mode";
		qcom,mdss-dsi-h-sync-pulse = <0>;
		qcom,mdss-dsi-traffic-mode = "non_burst_sync_event";
		qcom,mdss-dsi-lane-map = "lane_map_0123";
		qcom,mdss-dsi-bllp-eof-power-mode;
		qcom,mdss-dsi-bllp-power-mode;
		qcom,mdss-dsi-lane-0-state;
		qcom,mdss-dsi-lane-1-state;
		qcom,mdss-dsi-panel-timings = [8B 1F 14 00 45 4A 19 23 23 03 04 00];
		qcom,mdss-dsi-t-clk-post = <0x04>;
		qcom,mdss-dsi-t-clk-pre = <0x1b>;
		qcom,mdss-dsi-bl-min-level = <1>;
		qcom,mdss-dsi-bl-max-level = <4095>;
		qcom,mdss-dsi-dma-trigger = "trigger_sw";
		qcom,mdss-dsi-mdp-trigger = "none";
		qcom,mdss-dsi-bl-pmic-control-type = "bl_ctrl_wled";
		qcom,mdss-dsi-reset-sequence = <1 20>, <0 2>, <1 20>;
	};
};
