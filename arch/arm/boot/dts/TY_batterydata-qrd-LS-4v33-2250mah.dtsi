/* Copyright (c) 2013, The Linux Foundation. All rights reserved.
 *
 * This program is free software; you can redistribute it and/or modify
 * it under the terms of the GNU General Public License version 2 and
 * only version 2 as published by the Free Software Foundation.
 *
 * This program is distributed in the hope that it will be useful,
 * but WITHOUT ANY WARRANTY; without even the implied warranty of
 * MERCHANTABILITY or FITNESS FOR A PARTICULAR PURPOSE.  See the
 * GNU General Public License for more details.
 */

qcom,qrd-ls-4v33-2250mah-data {
	qcom,fcc-mah = <2250>;
	qcom,default-rbatt-mohm = <140>;
	qcom,rbatt-capacitive-mohm = <0>;
	qcom,flat-ocv-threshold-uv = <3800000>;
	qcom,max-voltage-uv = <4330000>;
	qcom,v-cutoff-uv = <3400000>;
	qcom,chg-term-ua = <100000>;
	qcom,batt-id-kohm = <36>;

	qcom,rbatt-sf-lut {
		qcom,lut-col-legend = <(-20) 0 25 40 60>;
		qcom,lut-row-legend = <100 95 90 85 80>,
				<75 70 65 60 55>,
				<50 45 40 35 30>,
				<25 20 15 10 9>,
				<8 7 6 5 4>,
				<3 2 1 0>;
		qcom,lut-data = <120  111 79  143 133>,
										<929  234 85  99  128>,
										<845  227 87  106 129>,
										<797  226 91  107 131>,
										<733  220 94  108 132>,
										<683  223 105 112 133>,
										<669  199 99  116 136>,
										<659  189 91  122 140>,
										<653  187 79  118 144>,
										<653  185 75  105 132>,
										<657  157 73  101 128>,
										<582  189 74  102 131>,
										<687  195 74  105 132>,
										<713  200 74  106 135>,
										<745  211 72  106 135>,
										<784  225 75  102 129>,
										<831  254 81  103 130>,
										<885  286 87  105 131>,
										<947  363 94  105 130>,
										<955  380 101 108 131>,
										<966  389 113 110 133>,
										<988  424 130 115 135>,
										<999  466 140 116 136>,
										<1010 500 154 118 137>,
										<1020 524 186 119 139>,
										<1033 600 218 126 144>,
										<1057 712 278 140 152>,
										<1078 855 391 186 176>,
										<2000 1100 450 220 210>;
	};

	qcom,fcc-temp-lut {
		qcom,lut-col-legend = <(-20) 0 25 40 60>;
		qcom,lut-data = <1806 2167 2287 2287 2287>;
	};

	qcom,pc-temp-ocv-lut {
		qcom,lut-col-legend = <(-20) 0 25 40 60>;
		qcom,lut-row-legend = <100 95 90 85 80>,
				<75 70 65 60 55>,
				<50 45 40 35 30>,
				<25 20 15 10 9>,
				<8 7 6 5 4>,
				<3 2 1 0>;
		qcom,lut-data = <4318 4325 4314 4313 4314>,
										<4240 4261 4262 4263 4261>,
										<4156 4210 4201 4202 4199>,
										<4092 4149 4143 4142 4140>,
										<4021 4088 4100 4100 4097>,
										<3962 4048 4051 4046 4044>,
										<3927 3971 3981 3992 3994>,
										<3895 3932 3932 3951 3950>,
										<3866 3895 3889 3902 3906>,
										<3841 3860 3861 3865 3865>,
										<3820 3846 3832 3832 3831>,
										<3805 3817 3808 3808 3806>,
										<3792 3798 3788 3789 3786>,
										<3783 3779 3772 3773 3770>,
										<3774 3768 3763 3762 3759>,
										<3764 3761 3752 3743 3728>,
										<3755 3747 3738 3724 3710>,
										<3745 3733 3712 3697 3683>,
										<3734 3706 3685 3674 3662>,
										<3732 3700 3680 3672 3661>,
										<3730 3698 3677 3670 3659>,
										<3727 3691 3672 3667 3655>,
										<3725 3684 3669 3661 3650>,
										<3722 3681 3665 3658 3643>,
										<3720 3679 3647 3621 3600>,
										<3718 3672 3599 3554 3536>,
										<3714 3662 3522 3457 3443>,
										<3709 3647 3407 3291 3288>,
										<3000 3000 3000 3000 3000>;
	};
};
