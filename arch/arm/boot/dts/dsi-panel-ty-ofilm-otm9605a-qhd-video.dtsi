/* Copyright (c) 2013, The Linux Foundation. All rights reserved.
 *
 * This program is free software; you can redistribute it and/or modify
 * it under the terms of the GNU General Public License version 2 and
 * only version 2 as published by the Free Software Foundation.
 *
 * This program is distributed in the hope that it will be useful,
 * but WITHOUT ANY WARRANTY; without even the implied warranty of
 * MERCHANTABILITY or FITNESS FOR A PARTICULAR PURPOSE.  See the
 * GNU General Public License for more details.

 */

/*---------------------------------------------------------------------------
 * This file is autogenerated file using gcdb parser. Please do not edit it.
 * Update input XML file to add a new entry or update variable in this file
 * VERSION = "1.0"
 *---------------------------------------------------------------------------*/
&mdss_mdp {
	dsi_ty_ofilm_otm9605a_qhd_vid: qcom,mdss_dsi_ty_ofilm_otm9605a_qhd_video {
		qcom,mdss-dsi-panel-name = "ofilm_otm9605a qhd video mode dsi panel";
                qcom,cont-splash-enabled;
		qcom,mdss-dsi-panel-controller = <&mdss_dsi0>;
		qcom,mdss-dsi-panel-type = "dsi_video_mode";
		qcom,mdss-dsi-panel-destination = "display_1";
		qcom,mdss-dsi-panel-framerate = <60>;
		qcom,mdss-dsi-virtual-channel-id = <0>;
		qcom,mdss-dsi-stream = <0>;
		qcom,mdss-dsi-panel-width = <540>;
		qcom,mdss-dsi-panel-height = <960>;
		qcom,mdss-dsi-h-front-porch = <32>;
		qcom,mdss-dsi-h-back-porch = <32>;
		qcom,mdss-dsi-h-pulse-width = <4>;
		qcom,mdss-dsi-h-sync-skew = <0>;
		qcom,mdss-dsi-v-back-porch = <16>;
		qcom,mdss-dsi-v-front-porch = <15>;
		qcom,mdss-dsi-v-pulse-width = <1>;
		qcom,mdss-dsi-h-left-border = <0>;
		qcom,mdss-dsi-h-right-border = <0>;
		qcom,mdss-dsi-v-top-border = <0>;
		qcom,mdss-dsi-v-bottom-border = <0>;
		qcom,mdss-dsi-bpp = <24>;
		qcom,mdss-dsi-color-order = "rgb_swap_rgb";
		qcom,mdss-dsi-underflow-color = <0xff>;
		qcom,mdss-dsi-border-color = <0>;
		qcom,mdss-dsi-pixel-packing = "tight";
		qcom,mdss-dsi-on-command = [      
                15 01 00 00 00 00 02
                      00 00   
                39 01 00 00 00 00 04
                      FF 96 05 01
                15 01 00 00 00 00 02
                      00 80 
                39 01 00 00 00 00 03
                      FF 96 05 
                15 01 00 00 00 00 02
                      00 92
                39 01 00 00 00 00 03
                      FF 10 02
                15 01 00 00 00 00 02
                      00 B4
                15 01 00 00 00 00 02
                      C0 50
                15 01 00 00 00 00 02
                      00 80
                39 01 00 00 00 00 03
                      C1 36 66
                15 01 00 00 00 00 02
                      00 89
                15 01 00 00 00 00 02
                      C0 01
                15 01 00 00 00 00 02
                      00 A0
                15 01 00 00 00 00 02
                      C1 02
                15 01 00 00 00 00 02
                      00 80
                39 01 00 00 00 00 05
                      C5 0c 00 b0 
                      11
                15 01 00 00 00 00 02
                      00 90
                39 01 00 00 00 00 06
                      C5 D6 57 01 03 33
                 15 01 00 00 00 00 02
                      00 b0
                39 01 00 00 00 00 03
                      C5 05 28
                15 01 00 00 00 00 02
                      00 00
                39 01 00 00 00 00 03
                      D8 85 85
                15 01 00 00 00 00 02
                      00 00
                15 01 00 00 00 00 02
                      D9 47
                15 01 00 00 00 00 02
                      00 A6
                 15 01 00 00 00 00 02
                      C1 01
                15 01 00 00 00 00 02
                      00 A2
                39 01 00 00 00 00 04
                      C0 0C 05 02
                15 01 00 00 00 00 02
                      00 80
                39 01 00 00 00 00 0b
                      CB 00 00 00 
                      00 00 00 00 
                      00 00 00
                15 01 00 00 00 00 02
                      00 90
                 39 01 00 00 00 00 10
                      CB 00 00 00 
                      00 00 00 00 
                      00 00 00 00 
                      00 00 00 00
                15 01 00 00 00 00 02
                      00 A0
                39 01 00 00 00 00 10 
                      CB 00 00 00 
                      00 00 00 00 
                      00 00 00 00 
                      00 00 00 00
                15 01 00 00 00 00 02
                      00 B0
                39 01 00 00 00 00 0B
                      CB 00 00 00 
                      00 00 00 00 
                      00 00 00
                15 01 00 00 00 00 02
                      00 C0
                39 01 00 00 00 00 10
                      CB 04 04 04 
                      04 08 04 08 
                      04 08 04 08 
                      04 04 04 08
                15 01 00 00 00 00 02
                      00 D0
                39 01 00 00 00 00 10
                      CB 08 00 00 
                      00 00 04 04 
                      04 04 08 04 
                      08 04 08 04
                15 01 00 00 00 00 02
                      00 E0
                39 01 00 00 00 00 0B
                      CB 08 04 04 
                      04 08 08 00 
                      00 00 00
                15 01 00 00 00 00 02
                      00 F0
                39 01 00 00 00 00 0B
                      CB FF FF FF 
                      FF FF FF FF 
                      FF FF FF
                15 01 00 00 00 00 02
                      00 80
                39 01 00 00 00 00 0B
                      CC 26 25 21 
                      22 00 0F 00 
                      0D 00 0B
                15 01 00 00 00 00 02
                      00 90
                39 01 00 00 00 00 10
                      CC 00 09 01 
                      03 00 00 00 
                      00 00 00 26 
                      25 21 22 00
                15 01 00 00 00 00 02
                      00 A0
                39 01 00 00 00 00 10
                      CC 10 00 0E 
                      00 0C 00 0A 
                      02 04 00 00 
                      00 00 00 00
                15 01 00 00 00 00 02
                      00 80
                39 01 00 00 00 00 0D
                      CE 8B 03 06 
                      8A 03 06 89 
                      03 06 88 03 
                      06
                15 01 00 00 00 00 02
                      00 90
                39 01 00 00 00 00 0f
                      CE F0 00 00 
                      F0 00 00 F0 
                      00 00 F0 00 
                      00 00 00
                15 01 00 00 00 00 02
                      00 A0
                39 01 00 00 00 00 0f
                      CE 38 03 03 
                      C0 00 06 00 
                      38 02 03 C1 
                      00 06 00
                15 01 00 00 00 00 02
                      00 B0
                39 01 00 00 00 00 0f
                      CE 38 01 03 
                      C2 00 06 00 
                      38 00 03 C3 
                      00 06 00
                15 01 00 00 00 00 02
                      00 C0
                39 01 00 00 00 00 0f
                      CE 38 07 03 
                      BC 00 06 00 
                      38 06 03 BD 
                      00 06 00
                15 01 00 00 00 00 02
                      00 D0
                39 01 00 00 00 00 0F
                      CE 38 05 03 
                      BE 00 06 00 
                      38 04 03 BF 
                      00 06 00
                15 01 00 00 00 00 02
                      00 80
                39 01 00 00 00 00 0F
                      CF F0 00 00 
                      10 00 00 00 
                      F0 00 00 10 
                      00 00 00
                15 01 00 00 00 00 02
                      00 90
                39 01 00 00 00 00 0f
                      CF F0 00 00 
                      10 00 00 00 
                      F0 00 00 10 
                      00 00 00
                15 01 00 00 00 00 02
                      00 A0
                39 01 00 00 00 00 0f
                      CF F0 00 00 
                      10 00 00 00 
                      F0 00 00 10 
                      00 00 00
                15 01 00 00 00 00 02
                      00 B0
                39 01 00 00 00 00 0F
                      CF F0 00 00 
                      10 00 00 00 
                      F0 00 00 10 
                      00 00 00
                15 01 00 00 00 00 02
                      00 C0
                39 01 00 00 00 00 0B
                      CF 02 02 20 
                      20 00 00 01 
                      02 00 02
                15 01 00 00 00 00 02
                      00 00
                39 01 00 00 00 00 09
                      E1 00 0B 11 
                      10 07 0E 09 
                      07
                39 01 00 00 00 00 09
                      E1 05 06 12 
                      08 0f 0d 08
                      03
                15 01 00 00 00 00 02
                      00 00
                39 01 00 00 00 00 09
                      E2 00 0B 11 
                      10 07 0E 09 
                      07 
                39 01 00 00 00 00 09
                      E2 05 06 12 
                      08 0f 0d 03 
                      03 
                15 01 00 00 00 00 02
                      00 00 
                39 01 00 00 00 00 04
                      FF FF FF FF
                05 01 00 00 C8 00 02 11 00 
	 	05 01 00 00 14 00 02 29 00];
		qcom,mdss-dsi-off-command = [
		05 01 00 00 32 00 02 28 00 
		05 01 00 00 78 00 02 10 00 
		]; 
		qcom,mdss-dsi-on-command-state = "dsi_lp_mode";
		qcom,mdss-dsi-off-command-state = "dsi_lp_mode";
		qcom,mdss-dsi-h-sync-pulse = <0>;
		qcom,mdss-dsi-traffic-mode = "non_burst_sync_event";
		qcom,mdss-dsi-lane-map = "lane_map_3012";
		qcom,mdss-dsi-bllp-eof-power-mode;
		qcom,mdss-dsi-lane-0-state;
		qcom,mdss-dsi-lane-1-state;
		qcom,mdss-dsi-panel-timings = [a8 1f 17 00 2f 2d 1c 21 29 03 04 00];
		qcom,mdss-dsi-t-clk-post = <0x20>;
		qcom,mdss-dsi-t-clk-pre = <0x2f>;
		qcom,mdss-dsi-bl-min-level = <1>;
		qcom,mdss-dsi-bl-max-level = <4095>;
		qcom,mdss-dsi-dma-trigger = "trigger_sw";
		qcom,mdss-dsi-mdp-trigger = "none";
		qcom,mdss-dsi-bl-pmic-control-type = "bl_ctrl_wled";
		qcom,mdss-dsi-reset-sequence = <1 20>, <0 2>, <1 20>;
		qcom,mdss-dsi-lp11-init;
		qcom,mdss-dsi-init-delay-us = <50000>;
	};
};
