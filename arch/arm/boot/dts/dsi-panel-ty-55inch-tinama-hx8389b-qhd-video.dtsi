/* Copyright (c) 2013, The Linux Foundation. All rights reserved.
 *
 * This program is free software; you can redistribute it and/or modify
 * it under the terms of the GNU General Public License version 2 and
 * only version 2 as published by the Free Software Foundation.
 *
 * This program is distributed in the hope that it will be useful,
 * but WITHOUT ANY WARRANTY; without even the implied warranty of
 * MERCHANTABILITY or FITNESS FOR A PARTICULAR PURPOSE.  See the
 * GNU General Public License for more details.
 */

/*---------------------------------------------------------------------------
 * This file is autogenerated file using gcdb parser. Please do not edit it.
 * Update input XML file to add a new entry or update variable in this file
 * VERSION = "1.0"
 *---------------------------------------------------------------------------*/
&mdss_mdp {
	ty_5_5inch_tianma_hx8389b_qhd: qcom,mdss_dsi_ty_5_5_tianma_hx8389b_qhd_video {
		qcom,mdss-dsi-panel-name = "ty_5_5inch_tianma_hx8389b_qhd_video dsi panel";
                qcom,cont-splash-enabled;
		qcom,mdss-dsi-panel-controller = <&mdss_dsi0>;
		qcom,mdss-dsi-panel-type = "dsi_video_mode";
		qcom,mdss-dsi-panel-destination = "display_1";
		qcom,mdss-dsi-panel-framerate = <58>;
		qcom,mdss-dsi-virtual-channel-id = <0>;
		qcom,mdss-dsi-stream = <0>;
		qcom,mdss-dsi-panel-width = <540>;
		qcom,mdss-dsi-panel-height = <960>;
		qcom,mdss-dsi-h-front-porch = <60>;
		qcom,mdss-dsi-h-back-porch = <60>;
		qcom,mdss-dsi-h-pulse-width = <2>;
		qcom,mdss-dsi-h-sync-skew = <0>;
		qcom,mdss-dsi-v-back-porch = <16>;
		qcom,mdss-dsi-v-front-porch = <15>;
		qcom,mdss-dsi-v-pulse-width = <2>;
		qcom,mdss-dsi-h-left-border = <0>;
		qcom,mdss-dsi-h-right-border = <0>;
		qcom,mdss-dsi-v-top-border = <0>;
		qcom,mdss-dsi-v-bottom-border = <0>;
		qcom,mdss-dsi-bpp = <24>;
		qcom,mdss-dsi-color-order = <0>;
		qcom,mdss-dsi-underflow-color = <0xff>;
		qcom,mdss-dsi-border-color = <0>;
		qcom,mdss-dsi-on-command = [
39 01 00 00 00 00 04  B9  FF  83  89

39 01 00 00 00 00 08 BA  41  93  00 16  A4  10  18  

39 01 00 00 00 00 02  C6  08  

39 01 00 00 00 00 02 CC  02  

39 01 00 00 00 00  14  
		  B1  00  00  07 
		  EF  97  10  11 
		  94  F1  26  2E 
		  3F  3F  42  01 
		  32  F7  20  80 

39 01 00 00 00 00  04 
		 DE  05  58  10 

39 01 00 00 00 00 08  
		 B2  00  00  78 
		  0E  03  3F  80 

39 01 00 00 00 00 18
		 B4  80  08  00 
		  32  10  07  32 
		  10  07  32  10 
		  07  27  01  5A 
		  0B  37  05  4C 
		  14  50  5B  0A 

39 01 00 00 00 00 31
		  D5  00  00  00 
		  00  01  00  00 
		  00  60  00  99 
		  88  88  88  88 
		  23  88  01  88 
		  67  88  45  01 
		  23  23  88  88 
		  88  88  88  99 
		  88  88  88  54 
		  88  76  88  10 
		  88  32  32  10 
		  88  88  88  88 
		  88  

39 01 00 00 00 00 23 
		 E0  01  1D  23 
		  34  32  3F  30 
		  4A  07  0D  10 
		  13  16  13  14 
		  0F  19  01  1D 
		  23  34  32  3F 
		  30  4A  07  0D 
		  10  13  16  13 
		  14  0F  19   

39 01 00 00 00 00 05
		 B6  00  87  00 89

39 01 00 00 00 00 04 B7  00  00  50 

39 01 00 00 00 00 02 35  01 
05 01 00 00 96 00 02 11 00 
05 01 00 00 14 00 02 29 00];
		qcom,mdss-dsi-off-command = [
		05 01 00 00 14 00 02 28 00 
		05 01 00 00 96 00 02 10 00 
		];
		qcom,mdss-dsi-on-command-state = "dsi_lp_mode";
		qcom,mdss-dsi-off-command-state = "dsi_hs_mode";
		qcom,mdss-dsi-h-sync-pulse = <0>;
		qcom,mdss-dsi-traffic-mode = "non_burst_sync_event";
		qcom,mdss-dsi-lane-map = "lane_map_3012";
		qcom,mdss-dsi-bllp-eof-power-mode;
		qcom,mdss-dsi-bllp-power-mode;
		qcom,mdss-dsi-lane-0-state;
		qcom,mdss-dsi-lane-1-state;
		qcom,mdss-dsi-panel-timings = [a8 1f 17 00 2f 2d 1c 21 29 03 04 00];
		qcom,mdss-dsi-t-clk-post = <0x20>;
		qcom,mdss-dsi-t-clk-pre = <0x2f>;
		qcom,mdss-dsi-bl-min-level = <1>;
		qcom,mdss-dsi-bl-max-level = <4095>;
		qcom,mdss-dsi-dma-trigger = "trigger_sw";
		qcom,mdss-dsi-mdp-trigger = "none";
		qcom,mdss-dsi-bl-pmic-control-type = "bl_ctrl_wled";
		qcom,mdss-dsi-reset-sequence = <1 20>, <0 1>, <1 20>;
	};
};
