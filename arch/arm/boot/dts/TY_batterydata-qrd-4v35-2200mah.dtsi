/* Copyright (c) 2013, The Linux Foundation. All rights reserved.
 *
 * This program is free software; you can redistribute it and/or modify
 * it under the terms of the GNU General Public License version 2 and
 * only version 2 as published by the Free Software Foundation.
 *
 * This program is distributed in the hope that it will be useful,
 * but WITHOUT ANY WARRANTY; without even the implied warranty of
 * MERCHANTABILITY or FITNESS FOR A PARTICULAR PURPOSE.  See the
 * GNU General Public License for more details.
 */

qcom,qrd-4v35-2200mah-data {
	qcom,fcc-mah = <2200>;
	qcom,default-rbatt-mohm = <166>;
	qcom,rbatt-capacitive-mohm = <0>;
	qcom,flat-ocv-threshold-uv = <3800000>;
	qcom,max-voltage-uv = <4350000>;
	qcom,v-cutoff-uv = <3400000>;
	qcom,chg-term-ua = <100000>;
	qcom,batt-id-kohm = <4>;

	qcom,rbatt-sf-lut {
		qcom,lut-col-legend = <(-20) 0 25 40 60>;
		qcom,lut-row-legend = <100 95 90 85 80>,
				<75 70 65 60 55>,
				<50 45 40 35 30>,
				<25 20 15 10 9>,
				<8 7 6 5 4>,
				<3 2 1 0>;
		qcom,lut-data = <199  142 100 95  93 >,
				<204  143 100 95  93 >,
				<654  187 102 97  93 >,
				<916  196 104 99  95 >,
				<846  205 108 102 96 >,
				<730  223 113 105 100>,
				<730  195 116 108 102>,
				<716  185 125 112 106>,
				<714  178 128 118 109>,
				<730  172 114 112 104>,
				<754  174 101 98  94 >,
				<791  177 103 99  96 >,
				<839  180 106 102 99 >,
				<895  184 107 104 101>,
				<963  196 110 103 100>,
				<1035 210 108 100 97 >,
				<1122 222 106 99  96 >,
				<1204 225 105 98  95 >,
				<1239 247 106 100 98 >,
				<1280 263 109 102 100>,
				<1333 285 112 104 100>,
				<1396 310 114 105 98 >,
				<1518 336 113 103 97 >,
				<1761 360 109 101 98 >,
				<2107 394 110 103 104>,
				<2651 457 115 105 119>,
				<3620 554 128 116 165>,
				<7374 746 162 159 745>,
				<39377 13456 5809 14129 10751>;
	};

	qcom,fcc-temp-lut {
		qcom,lut-col-legend = <(-20) 0 25 40 60>;
		qcom,lut-data = <2229 2235 2237 2228 2251>;
	};

	qcom,pc-temp-ocv-lut {
		qcom,lut-col-legend = <(-20) 0 25 40 60>;
		qcom,lut-row-legend = <100 95 90 85 80>,
				<75 70 65 60 55>,
				<50 45 40 35 30>,
				<25 20 15 10 9>,
				<8 7 6 5 4>,
				<3 2 1 0>;
		qcom,lut-data = <4311 4316 4319 4318 4310>,
				<4237 4250 4254 4252 4246>,
				<4154 4190 4198 4196 4190>,
				<4087 4137 4143 4141 4136>,
				<4033 4088 4091 4090 4084>,
				<3936 4041 4048 4044 4036>,
				<3902 3965 3992 3994 3992>,
				<3865 3923 3958 3958 3953>,
				<3833 3887 3920 3921 3915>,
				<3813 3854 3873 3877 3871>,
				<3799 3829 3837 3837 3834>,
				<3786 3808 3814 3814 3811>,
				<3774 3791 3796 3796 3793>,
				<3761 3779 3781 3781 3778>,
				<3749 3773 3770 3766 3760>,
				<3737 3763 3759 3750 3736>,
				<3724 3743 3738 3729 3712>,
				<3712 3718 3710 3702 3683>,
				<3684 3692 3684 3677 3666>,
				<3675 3689 3683 3676 3664>,
				<3665 3686 3682 3675 3661>,
				<3650 3683 3679 3671 3649>,
				<3630 3673 3669 3659 3617>,
				<3602 3648 3638 3627 3569>,
				<3561 3601 3589 3578 3507>,
				<3503 3536 3525 3512 3430>,
				<3419 3449 3438 3426 3331>,
				<3286 3321 3311 3291 3201>,
				<3000 3000 3000 3000 3000>;
	};
};
