//======================================================
/* Copyright (c) 2013, The Linux Foundation. All rights reserved.
 *
 * This program is free software; you can redistribute it and/or modify
 * it under the terms of the GNU General Public License version 2 and
 * only version 2 as published by the Free Software Foundation.
 *
 * This program is distributed in the hope that it will be useful,
 * but WITHOUT ANY WARRANTY; without even the implied warranty of
 * MERCHANTABILITY or FITNESS FOR A PARTICULAR PURPOSE.  See the
 * GNU General Public License for more details.
 */

/*---------------------------------------------------------------------------
 * This file is autogenerated file using gcdb parser. Please do not edit it.
 * Update input XML file to add a new entry or update variable in this file
 * VERSION = "1.0"
 *---------------------------------------------------------------------------*/
&mdss_mdp {
	dsi_ty_5inch_hx8394d_hd_vid: qcom,mdss_dsi_ty_5inch_hx8394d_hd_video{
		qcom,mdss-dsi-panel-name = "hx8394d 5inch hd ty video mode dsi panel";
		qcom,cont-splash-enabled;
		qcom,mdss-dsi-panel-controller = <&mdss_dsi0>;
		qcom,mdss-dsi-panel-type = "dsi_video_mode";
		qcom,mdss-dsi-panel-destination = "display_1";
		qcom,mdss-dsi-panel-framerate = <60>;
		qcom,mdss-dsi-virtual-channel-id = <0>;
		qcom,mdss-dsi-stream = <0>;
		qcom,mdss-dsi-panel-width = <720>;
		qcom,mdss-dsi-panel-height = <1280>;
		qcom,mdss-dsi-h-front-porch = <80>;
		qcom,mdss-dsi-h-back-porch = <80>;
		qcom,mdss-dsi-h-pulse-width = <60>;
		qcom,mdss-dsi-h-sync-skew = <0>;
		qcom,mdss-dsi-v-back-porch = <12>;
		qcom,mdss-dsi-v-front-porch = <15>;
		qcom,mdss-dsi-v-pulse-width = <4>;
		qcom,mdss-dsi-h-left-border = <0>;
		qcom,mdss-dsi-h-right-border = <0>;
		qcom,mdss-dsi-v-top-border = <0>;
		qcom,mdss-dsi-v-bottom-border = <0>;
		qcom,mdss-dsi-bpp = <24>;
		qcom,mdss-dsi-underflow-color = <0xff>;
		qcom,mdss-dsi-border-color = <0>;
		qcom,mdss-dsi-on-command = [
              39 01 00 00 00 00 04 B9 FF 83 94 
	 	15 01 00 00 00 00 03 BA 33 83 
	 	39 01 00 00 00 00 10 B1 6C 12 12 26 04 11 F1 81 3A 54 23 80 C0 D2 58 
	 	39 01 00 00 00 00 0D B4 00 FF 51 5A 59 5A 03 5A 01 60 20 60 
	 	39 01 00 00 00 00 0C B2 00 64 0E 0D 22 1C 08 08 1C 4D 00
	 	39 01 00 00 00 00 02 BC 07
	 	39 01 00 00 00 00 04 BF 41 0E 01
	 	39 01 00 00 00 00 1F D3 00 00 00 40 07 10 00 08 10 08 
                                      00 08 54 15 0E 05 0E 02 15 06 
                                      05 06 47 44 0A 0A 4B 10 07 07

		39 01 00 00 00 00 2D D5 1A 1A 1B 1B 00 01 02 03 04 05 
                                      06 07 08 09 0A 0B 24 25 18 18 
                                      26 27 18 18 18 18 18 18 18 18 
                                      18 18 18 18 18 18 18 18 20 21 
                                      18 18 18 18

              39 01 00 00 00 00 2D D6 1A 1A 1B 1B 0B 0A 09 08 07 06 
                                      05 04 03 02 01 00 21 20 58 58 
                                      27 26 18 18 18 18 18 18 18 18 
                                      18 18 18 18 18 18 18 18 25 24 
                                      18 18 18 18 

              39 01 00 00 00 00 2B E0 00 13 17 33 3A 3F 24 3B 0B 0E 0F 1A 10 13 15 13 14 07 11 13 17 
                                      00 13 17 33 3A 3F 24 3B 0B 0E 0F 1A 10 13 15 13 14 07 11 13 17
                                      
	 	15 01 00 00 00 00 02 CC 09
              39 01 00 00 00 00 03 C0 30 14
	 	39 01 00 00 00 00 05 C7 00 C0 40 C0 
	 	39 01 00 00 00 00 03 B6 7A 7A
		05 01 00 00 C8 00 02 11 00 
	 	05 01 00 00 14 00 02 29 00];
		qcom,mdss-dsi-off-command = [
	 05 01 00 00 32 00 02 28 00 
	 05 01 00 00 78 00 02 10 00 
		];
		qcom,mdss-dsi-on-command-state = "dsi_lp_mode";
		qcom,mdss-dsi-off-command-state = "dsi_hs_mode";
		qcom,mdss-dsi-h-sync-pulse = <1>;
		qcom,mdss-dsi-traffic-mode = "burst_mode";
		qcom,mdss-dsi-bllp-eof-power-mode;
		qcom,mdss-dsi-bllp-power-mode;
		qcom,mdss-dsi-lane-0-state;
		qcom,mdss-dsi-lane-1-state;
		qcom,mdss-dsi-lane-2-state;
		qcom,mdss-dsi-lane-3-state;
		qcom,mdss-dsi-panel-timings = [64 25 1D 00 37 33 22 27 30 03 04 00];
		qcom,mdss-dsi-t-clk-post = <0x20>;
		qcom,mdss-dsi-t-clk-pre = <0x3B>;
		qcom,mdss-dsi-bl-min-level = <1>;
		qcom,mdss-dsi-bl-max-level = <4095>;
		qcom,mdss-dsi-dma-trigger = "trigger_sw";
		qcom,mdss-dsi-mdp-trigger = "none";
		qcom,mdss-dsi-bl-pmic-control-type = "bl_ctrl_wled";
		qcom,mdss-dsi-lp11-init;
		qcom,mdss-dsi-reset-sequence = <1 20>, <0 10>, <1 200>;

		qcom,mdss-dsi-init-delay-us = <50000>;

	};
};
	
